    IF :LNOT::DEF:INCLUDED_CYFITTERRV_INC
INCLUDED_CYFITTERRV_INC EQU 1
    GET cydevicerv.inc
    GET cydevicerv_trm.inc

; Counter_1_CounterHW
Counter_1_CounterHW__CAP0 EQU CYREG_TMR0_CAP0
Counter_1_CounterHW__CAP1 EQU CYREG_TMR0_CAP1
Counter_1_CounterHW__CFG0 EQU CYREG_TMR0_CFG0
Counter_1_CounterHW__CFG1 EQU CYREG_TMR0_CFG1
Counter_1_CounterHW__CFG2 EQU CYREG_TMR0_CFG2
Counter_1_CounterHW__CNT_CMP0 EQU CYREG_TMR0_CNT_CMP0
Counter_1_CounterHW__CNT_CMP1 EQU CYREG_TMR0_CNT_CMP1
Counter_1_CounterHW__PER0 EQU CYREG_TMR0_PER0
Counter_1_CounterHW__PER1 EQU CYREG_TMR0_PER1
Counter_1_CounterHW__PM_ACT_CFG EQU CYREG_PM_ACT_CFG3
Counter_1_CounterHW__PM_ACT_MSK EQU 0x01
Counter_1_CounterHW__PM_STBY_CFG EQU CYREG_PM_STBY_CFG3
Counter_1_CounterHW__PM_STBY_MSK EQU 0x01
Counter_1_CounterHW__RT0 EQU CYREG_TMR0_RT0
Counter_1_CounterHW__RT1 EQU CYREG_TMR0_RT1
Counter_1_CounterHW__SR0 EQU CYREG_TMR0_SR0

; Counter_2_CounterHW
Counter_2_CounterHW__CAP0 EQU CYREG_TMR1_CAP0
Counter_2_CounterHW__CAP1 EQU CYREG_TMR1_CAP1
Counter_2_CounterHW__CFG0 EQU CYREG_TMR1_CFG0
Counter_2_CounterHW__CFG1 EQU CYREG_TMR1_CFG1
Counter_2_CounterHW__CFG2 EQU CYREG_TMR1_CFG2
Counter_2_CounterHW__CNT_CMP0 EQU CYREG_TMR1_CNT_CMP0
Counter_2_CounterHW__CNT_CMP1 EQU CYREG_TMR1_CNT_CMP1
Counter_2_CounterHW__PER0 EQU CYREG_TMR1_PER0
Counter_2_CounterHW__PER1 EQU CYREG_TMR1_PER1
Counter_2_CounterHW__PM_ACT_CFG EQU CYREG_PM_ACT_CFG3
Counter_2_CounterHW__PM_ACT_MSK EQU 0x02
Counter_2_CounterHW__PM_STBY_CFG EQU CYREG_PM_STBY_CFG3
Counter_2_CounterHW__PM_STBY_MSK EQU 0x02
Counter_2_CounterHW__RT0 EQU CYREG_TMR1_RT0
Counter_2_CounterHW__RT1 EQU CYREG_TMR1_RT1
Counter_2_CounterHW__SR0 EQU CYREG_TMR1_SR0

; throttle_update
throttle_update__INTC_CLR_EN_REG EQU CYREG_NVIC_CLRENA0
throttle_update__INTC_CLR_PD_REG EQU CYREG_NVIC_CLRPEND0
throttle_update__INTC_MASK EQU 0x20000
throttle_update__INTC_NUMBER EQU 17
throttle_update__INTC_PRIOR_NUM EQU 7
throttle_update__INTC_PRIOR_REG EQU CYREG_NVIC_PRI_17
throttle_update__INTC_SET_EN_REG EQU CYREG_NVIC_SETENA0
throttle_update__INTC_SET_PD_REG EQU CYREG_NVIC_SETPEND0

; Timer_1_TimerHW
Timer_1_TimerHW__CAP0 EQU CYREG_TMR2_CAP0
Timer_1_TimerHW__CAP1 EQU CYREG_TMR2_CAP1
Timer_1_TimerHW__CFG0 EQU CYREG_TMR2_CFG0
Timer_1_TimerHW__CFG1 EQU CYREG_TMR2_CFG1
Timer_1_TimerHW__CFG2 EQU CYREG_TMR2_CFG2
Timer_1_TimerHW__CNT_CMP0 EQU CYREG_TMR2_CNT_CMP0
Timer_1_TimerHW__CNT_CMP1 EQU CYREG_TMR2_CNT_CMP1
Timer_1_TimerHW__PER0 EQU CYREG_TMR2_PER0
Timer_1_TimerHW__PER1 EQU CYREG_TMR2_PER1
Timer_1_TimerHW__PM_ACT_CFG EQU CYREG_PM_ACT_CFG3
Timer_1_TimerHW__PM_ACT_MSK EQU 0x04
Timer_1_TimerHW__PM_STBY_CFG EQU CYREG_PM_STBY_CFG3
Timer_1_TimerHW__PM_STBY_MSK EQU 0x04
Timer_1_TimerHW__RT0 EQU CYREG_TMR2_RT0
Timer_1_TimerHW__RT1 EQU CYREG_TMR2_RT1
Timer_1_TimerHW__SR0 EQU CYREG_TMR2_SR0

; UART_1_IntClock
UART_1_IntClock__CFG0 EQU CYREG_CLKDIST_DCFG0_CFG0
UART_1_IntClock__CFG1 EQU CYREG_CLKDIST_DCFG0_CFG1
UART_1_IntClock__CFG2 EQU CYREG_CLKDIST_DCFG0_CFG2
UART_1_IntClock__CFG2_SRC_SEL_MASK EQU 0x07
UART_1_IntClock__INDEX EQU 0x00
UART_1_IntClock__PM_ACT_CFG EQU CYREG_PM_ACT_CFG2
UART_1_IntClock__PM_ACT_MSK EQU 0x01
UART_1_IntClock__PM_STBY_CFG EQU CYREG_PM_STBY_CFG2
UART_1_IntClock__PM_STBY_MSK EQU 0x01

; ShiftReg_1_bSR
ShiftReg_1_bSR_StsReg__16BIT_STATUS_AUX_CTL_REG EQU CYREG_B1_UDB04_05_ACTL
ShiftReg_1_bSR_StsReg__16BIT_STATUS_REG EQU CYREG_B1_UDB04_05_ST
ShiftReg_1_bSR_StsReg__3__MASK EQU 0x08
ShiftReg_1_bSR_StsReg__3__POS EQU 3
ShiftReg_1_bSR_StsReg__4__MASK EQU 0x10
ShiftReg_1_bSR_StsReg__4__POS EQU 4
ShiftReg_1_bSR_StsReg__5__MASK EQU 0x20
ShiftReg_1_bSR_StsReg__5__POS EQU 5
ShiftReg_1_bSR_StsReg__6__MASK EQU 0x40
ShiftReg_1_bSR_StsReg__6__POS EQU 6
ShiftReg_1_bSR_StsReg__MASK EQU 0x78
ShiftReg_1_bSR_StsReg__MASK_REG EQU CYREG_B1_UDB04_MSK
ShiftReg_1_bSR_StsReg__MASK_ST_AUX_CTL_REG EQU CYREG_B1_UDB04_MSK_ACTL
ShiftReg_1_bSR_StsReg__PER_ST_AUX_CTL_REG EQU CYREG_B1_UDB04_MSK_ACTL
ShiftReg_1_bSR_StsReg__STATUS_AUX_CTL_REG EQU CYREG_B1_UDB04_ACTL
ShiftReg_1_bSR_StsReg__STATUS_CNT_REG EQU CYREG_B1_UDB04_ST_CTL
ShiftReg_1_bSR_StsReg__STATUS_CONTROL_REG EQU CYREG_B1_UDB04_ST_CTL
ShiftReg_1_bSR_StsReg__STATUS_REG EQU CYREG_B1_UDB04_ST
ShiftReg_1_bSR_SyncCtl_CtrlReg__0__MASK EQU 0x01
ShiftReg_1_bSR_SyncCtl_CtrlReg__0__POS EQU 0
ShiftReg_1_bSR_SyncCtl_CtrlReg__16BIT_CONTROL_AUX_CTL_REG EQU CYREG_B1_UDB04_05_ACTL
ShiftReg_1_bSR_SyncCtl_CtrlReg__16BIT_CONTROL_CONTROL_REG EQU CYREG_B1_UDB04_05_CTL
ShiftReg_1_bSR_SyncCtl_CtrlReg__16BIT_CONTROL_COUNT_REG EQU CYREG_B1_UDB04_05_CTL
ShiftReg_1_bSR_SyncCtl_CtrlReg__16BIT_COUNT_CONTROL_REG EQU CYREG_B1_UDB04_05_CTL
ShiftReg_1_bSR_SyncCtl_CtrlReg__16BIT_COUNT_COUNT_REG EQU CYREG_B1_UDB04_05_CTL
ShiftReg_1_bSR_SyncCtl_CtrlReg__16BIT_MASK_MASK_REG EQU CYREG_B1_UDB04_05_MSK
ShiftReg_1_bSR_SyncCtl_CtrlReg__16BIT_MASK_PERIOD_REG EQU CYREG_B1_UDB04_05_MSK
ShiftReg_1_bSR_SyncCtl_CtrlReg__16BIT_PERIOD_MASK_REG EQU CYREG_B1_UDB04_05_MSK
ShiftReg_1_bSR_SyncCtl_CtrlReg__16BIT_PERIOD_PERIOD_REG EQU CYREG_B1_UDB04_05_MSK
ShiftReg_1_bSR_SyncCtl_CtrlReg__CONTROL_AUX_CTL_REG EQU CYREG_B1_UDB04_ACTL
ShiftReg_1_bSR_SyncCtl_CtrlReg__CONTROL_REG EQU CYREG_B1_UDB04_CTL
ShiftReg_1_bSR_SyncCtl_CtrlReg__CONTROL_ST_REG EQU CYREG_B1_UDB04_ST_CTL
ShiftReg_1_bSR_SyncCtl_CtrlReg__COUNT_REG EQU CYREG_B1_UDB04_CTL
ShiftReg_1_bSR_SyncCtl_CtrlReg__COUNT_ST_REG EQU CYREG_B1_UDB04_ST_CTL
ShiftReg_1_bSR_SyncCtl_CtrlReg__MASK EQU 0x01
ShiftReg_1_bSR_SyncCtl_CtrlReg__MASK_CTL_AUX_CTL_REG EQU CYREG_B1_UDB04_MSK_ACTL
ShiftReg_1_bSR_SyncCtl_CtrlReg__PERIOD_REG EQU CYREG_B1_UDB04_MSK
ShiftReg_1_bSR_SyncCtl_CtrlReg__PER_CTL_AUX_CTL_REG EQU CYREG_B1_UDB04_MSK_ACTL
ShiftReg_1_bSR_sC8_BShiftRegDp_u0__16BIT_A0_REG EQU CYREG_B1_UDB04_05_A0
ShiftReg_1_bSR_sC8_BShiftRegDp_u0__16BIT_A1_REG EQU CYREG_B1_UDB04_05_A1
ShiftReg_1_bSR_sC8_BShiftRegDp_u0__16BIT_D0_REG EQU CYREG_B1_UDB04_05_D0
ShiftReg_1_bSR_sC8_BShiftRegDp_u0__16BIT_D1_REG EQU CYREG_B1_UDB04_05_D1
ShiftReg_1_bSR_sC8_BShiftRegDp_u0__16BIT_DP_AUX_CTL_REG EQU CYREG_B1_UDB04_05_ACTL
ShiftReg_1_bSR_sC8_BShiftRegDp_u0__16BIT_F0_REG EQU CYREG_B1_UDB04_05_F0
ShiftReg_1_bSR_sC8_BShiftRegDp_u0__16BIT_F1_REG EQU CYREG_B1_UDB04_05_F1
ShiftReg_1_bSR_sC8_BShiftRegDp_u0__A0_A1_REG EQU CYREG_B1_UDB04_A0_A1
ShiftReg_1_bSR_sC8_BShiftRegDp_u0__A0_REG EQU CYREG_B1_UDB04_A0
ShiftReg_1_bSR_sC8_BShiftRegDp_u0__A1_REG EQU CYREG_B1_UDB04_A1
ShiftReg_1_bSR_sC8_BShiftRegDp_u0__D0_D1_REG EQU CYREG_B1_UDB04_D0_D1
ShiftReg_1_bSR_sC8_BShiftRegDp_u0__D0_REG EQU CYREG_B1_UDB04_D0
ShiftReg_1_bSR_sC8_BShiftRegDp_u0__D1_REG EQU CYREG_B1_UDB04_D1
ShiftReg_1_bSR_sC8_BShiftRegDp_u0__DP_AUX_CTL_REG EQU CYREG_B1_UDB04_ACTL
ShiftReg_1_bSR_sC8_BShiftRegDp_u0__F0_F1_REG EQU CYREG_B1_UDB04_F0_F1
ShiftReg_1_bSR_sC8_BShiftRegDp_u0__F0_REG EQU CYREG_B1_UDB04_F0
ShiftReg_1_bSR_sC8_BShiftRegDp_u0__F1_REG EQU CYREG_B1_UDB04_F1
ShiftReg_1_bSR_sC8_BShiftRegDp_u0__MSK_DP_AUX_CTL_REG EQU CYREG_B1_UDB04_MSK_ACTL
ShiftReg_1_bSR_sC8_BShiftRegDp_u0__PER_DP_AUX_CTL_REG EQU CYREG_B1_UDB04_MSK_ACTL

; inter_button
inter_button__INTC_CLR_EN_REG EQU CYREG_NVIC_CLRENA0
inter_button__INTC_CLR_PD_REG EQU CYREG_NVIC_CLRPEND0
inter_button__INTC_MASK EQU 0x01
inter_button__INTC_NUMBER EQU 0
inter_button__INTC_PRIOR_NUM EQU 7
inter_button__INTC_PRIOR_REG EQU CYREG_NVIC_PRI_0
inter_button__INTC_SET_EN_REG EQU CYREG_NVIC_SETENA0
inter_button__INTC_SET_PD_REG EQU CYREG_NVIC_SETPEND0

; tick_timeout
tick_timeout__INTC_CLR_EN_REG EQU CYREG_NVIC_CLRENA0
tick_timeout__INTC_CLR_PD_REG EQU CYREG_NVIC_CLRPEND0
tick_timeout__INTC_MASK EQU 0x04
tick_timeout__INTC_NUMBER EQU 2
tick_timeout__INTC_PRIOR_NUM EQU 7
tick_timeout__INTC_PRIOR_REG EQU CYREG_NVIC_PRI_2
tick_timeout__INTC_SET_EN_REG EQU CYREG_NVIC_SETENA0
tick_timeout__INTC_SET_PD_REG EQU CYREG_NVIC_SETPEND0

; UART_1_BUART
UART_1_BUART_sRX_RxBitCounter_ST__16BIT_STATUS_AUX_CTL_REG EQU CYREG_B1_UDB06_07_ACTL
UART_1_BUART_sRX_RxBitCounter_ST__16BIT_STATUS_REG EQU CYREG_B1_UDB06_07_ST
UART_1_BUART_sRX_RxBitCounter_ST__MASK_REG EQU CYREG_B1_UDB06_MSK
UART_1_BUART_sRX_RxBitCounter_ST__MASK_ST_AUX_CTL_REG EQU CYREG_B1_UDB06_MSK_ACTL
UART_1_BUART_sRX_RxBitCounter_ST__PER_ST_AUX_CTL_REG EQU CYREG_B1_UDB06_MSK_ACTL
UART_1_BUART_sRX_RxBitCounter_ST__STATUS_AUX_CTL_REG EQU CYREG_B1_UDB06_ACTL
UART_1_BUART_sRX_RxBitCounter_ST__STATUS_CNT_REG EQU CYREG_B1_UDB06_ST_CTL
UART_1_BUART_sRX_RxBitCounter_ST__STATUS_CONTROL_REG EQU CYREG_B1_UDB06_ST_CTL
UART_1_BUART_sRX_RxBitCounter_ST__STATUS_REG EQU CYREG_B1_UDB06_ST
UART_1_BUART_sRX_RxBitCounter__16BIT_CONTROL_AUX_CTL_REG EQU CYREG_B1_UDB06_07_ACTL
UART_1_BUART_sRX_RxBitCounter__16BIT_CONTROL_CONTROL_REG EQU CYREG_B1_UDB06_07_CTL
UART_1_BUART_sRX_RxBitCounter__16BIT_CONTROL_COUNT_REG EQU CYREG_B1_UDB06_07_CTL
UART_1_BUART_sRX_RxBitCounter__16BIT_COUNT_CONTROL_REG EQU CYREG_B1_UDB06_07_CTL
UART_1_BUART_sRX_RxBitCounter__16BIT_COUNT_COUNT_REG EQU CYREG_B1_UDB06_07_CTL
UART_1_BUART_sRX_RxBitCounter__16BIT_MASK_MASK_REG EQU CYREG_B1_UDB06_07_MSK
UART_1_BUART_sRX_RxBitCounter__16BIT_MASK_PERIOD_REG EQU CYREG_B1_UDB06_07_MSK
UART_1_BUART_sRX_RxBitCounter__16BIT_PERIOD_MASK_REG EQU CYREG_B1_UDB06_07_MSK
UART_1_BUART_sRX_RxBitCounter__16BIT_PERIOD_PERIOD_REG EQU CYREG_B1_UDB06_07_MSK
UART_1_BUART_sRX_RxBitCounter__CONTROL_AUX_CTL_REG EQU CYREG_B1_UDB06_ACTL
UART_1_BUART_sRX_RxBitCounter__CONTROL_REG EQU CYREG_B1_UDB06_CTL
UART_1_BUART_sRX_RxBitCounter__CONTROL_ST_REG EQU CYREG_B1_UDB06_ST_CTL
UART_1_BUART_sRX_RxBitCounter__COUNT_REG EQU CYREG_B1_UDB06_CTL
UART_1_BUART_sRX_RxBitCounter__COUNT_ST_REG EQU CYREG_B1_UDB06_ST_CTL
UART_1_BUART_sRX_RxBitCounter__MASK_CTL_AUX_CTL_REG EQU CYREG_B1_UDB06_MSK_ACTL
UART_1_BUART_sRX_RxBitCounter__PERIOD_REG EQU CYREG_B1_UDB06_MSK
UART_1_BUART_sRX_RxBitCounter__PER_CTL_AUX_CTL_REG EQU CYREG_B1_UDB06_MSK_ACTL
UART_1_BUART_sRX_RxShifter_u0__16BIT_A0_REG EQU CYREG_B1_UDB05_06_A0
UART_1_BUART_sRX_RxShifter_u0__16BIT_A1_REG EQU CYREG_B1_UDB05_06_A1
UART_1_BUART_sRX_RxShifter_u0__16BIT_D0_REG EQU CYREG_B1_UDB05_06_D0
UART_1_BUART_sRX_RxShifter_u0__16BIT_D1_REG EQU CYREG_B1_UDB05_06_D1
UART_1_BUART_sRX_RxShifter_u0__16BIT_DP_AUX_CTL_REG EQU CYREG_B1_UDB05_06_ACTL
UART_1_BUART_sRX_RxShifter_u0__16BIT_F0_REG EQU CYREG_B1_UDB05_06_F0
UART_1_BUART_sRX_RxShifter_u0__16BIT_F1_REG EQU CYREG_B1_UDB05_06_F1
UART_1_BUART_sRX_RxShifter_u0__A0_A1_REG EQU CYREG_B1_UDB05_A0_A1
UART_1_BUART_sRX_RxShifter_u0__A0_REG EQU CYREG_B1_UDB05_A0
UART_1_BUART_sRX_RxShifter_u0__A1_REG EQU CYREG_B1_UDB05_A1
UART_1_BUART_sRX_RxShifter_u0__D0_D1_REG EQU CYREG_B1_UDB05_D0_D1
UART_1_BUART_sRX_RxShifter_u0__D0_REG EQU CYREG_B1_UDB05_D0
UART_1_BUART_sRX_RxShifter_u0__D1_REG EQU CYREG_B1_UDB05_D1
UART_1_BUART_sRX_RxShifter_u0__DP_AUX_CTL_REG EQU CYREG_B1_UDB05_ACTL
UART_1_BUART_sRX_RxShifter_u0__F0_F1_REG EQU CYREG_B1_UDB05_F0_F1
UART_1_BUART_sRX_RxShifter_u0__F0_REG EQU CYREG_B1_UDB05_F0
UART_1_BUART_sRX_RxShifter_u0__F1_REG EQU CYREG_B1_UDB05_F1
UART_1_BUART_sRX_RxSts__16BIT_STATUS_AUX_CTL_REG EQU CYREG_B1_UDB05_06_ACTL
UART_1_BUART_sRX_RxSts__16BIT_STATUS_REG EQU CYREG_B1_UDB05_06_ST
UART_1_BUART_sRX_RxSts__3__MASK EQU 0x08
UART_1_BUART_sRX_RxSts__3__POS EQU 3
UART_1_BUART_sRX_RxSts__4__MASK EQU 0x10
UART_1_BUART_sRX_RxSts__4__POS EQU 4
UART_1_BUART_sRX_RxSts__5__MASK EQU 0x20
UART_1_BUART_sRX_RxSts__5__POS EQU 5
UART_1_BUART_sRX_RxSts__MASK EQU 0x38
UART_1_BUART_sRX_RxSts__MASK_REG EQU CYREG_B1_UDB05_MSK
UART_1_BUART_sRX_RxSts__STATUS_AUX_CTL_REG EQU CYREG_B1_UDB05_ACTL
UART_1_BUART_sRX_RxSts__STATUS_REG EQU CYREG_B1_UDB05_ST
UART_1_BUART_sTX_TxShifter_u0__16BIT_A0_REG EQU CYREG_B1_UDB08_09_A0
UART_1_BUART_sTX_TxShifter_u0__16BIT_A1_REG EQU CYREG_B1_UDB08_09_A1
UART_1_BUART_sTX_TxShifter_u0__16BIT_D0_REG EQU CYREG_B1_UDB08_09_D0
UART_1_BUART_sTX_TxShifter_u0__16BIT_D1_REG EQU CYREG_B1_UDB08_09_D1
UART_1_BUART_sTX_TxShifter_u0__16BIT_DP_AUX_CTL_REG EQU CYREG_B1_UDB08_09_ACTL
UART_1_BUART_sTX_TxShifter_u0__16BIT_F0_REG EQU CYREG_B1_UDB08_09_F0
UART_1_BUART_sTX_TxShifter_u0__16BIT_F1_REG EQU CYREG_B1_UDB08_09_F1
UART_1_BUART_sTX_TxShifter_u0__A0_A1_REG EQU CYREG_B1_UDB08_A0_A1
UART_1_BUART_sTX_TxShifter_u0__A0_REG EQU CYREG_B1_UDB08_A0
UART_1_BUART_sTX_TxShifter_u0__A1_REG EQU CYREG_B1_UDB08_A1
UART_1_BUART_sTX_TxShifter_u0__D0_D1_REG EQU CYREG_B1_UDB08_D0_D1
UART_1_BUART_sTX_TxShifter_u0__D0_REG EQU CYREG_B1_UDB08_D0
UART_1_BUART_sTX_TxShifter_u0__D1_REG EQU CYREG_B1_UDB08_D1
UART_1_BUART_sTX_TxShifter_u0__DP_AUX_CTL_REG EQU CYREG_B1_UDB08_ACTL
UART_1_BUART_sTX_TxShifter_u0__F0_F1_REG EQU CYREG_B1_UDB08_F0_F1
UART_1_BUART_sTX_TxShifter_u0__F0_REG EQU CYREG_B1_UDB08_F0
UART_1_BUART_sTX_TxShifter_u0__F1_REG EQU CYREG_B1_UDB08_F1
UART_1_BUART_sTX_TxSts__0__MASK EQU 0x01
UART_1_BUART_sTX_TxSts__0__POS EQU 0
UART_1_BUART_sTX_TxSts__16BIT_STATUS_AUX_CTL_REG EQU CYREG_B1_UDB08_09_ACTL
UART_1_BUART_sTX_TxSts__16BIT_STATUS_REG EQU CYREG_B1_UDB08_09_ST
UART_1_BUART_sTX_TxSts__1__MASK EQU 0x02
UART_1_BUART_sTX_TxSts__1__POS EQU 1
UART_1_BUART_sTX_TxSts__2__MASK EQU 0x04
UART_1_BUART_sTX_TxSts__2__POS EQU 2
UART_1_BUART_sTX_TxSts__3__MASK EQU 0x08
UART_1_BUART_sTX_TxSts__3__POS EQU 3
UART_1_BUART_sTX_TxSts__MASK EQU 0x0F
UART_1_BUART_sTX_TxSts__MASK_REG EQU CYREG_B1_UDB08_MSK
UART_1_BUART_sTX_TxSts__STATUS_AUX_CTL_REG EQU CYREG_B1_UDB08_ACTL
UART_1_BUART_sTX_TxSts__STATUS_REG EQU CYREG_B1_UDB08_ST
UART_1_BUART_sTX_sCLOCK_TxBitClkGen__16BIT_A0_REG EQU CYREG_B1_UDB09_10_A0
UART_1_BUART_sTX_sCLOCK_TxBitClkGen__16BIT_A1_REG EQU CYREG_B1_UDB09_10_A1
UART_1_BUART_sTX_sCLOCK_TxBitClkGen__16BIT_D0_REG EQU CYREG_B1_UDB09_10_D0
UART_1_BUART_sTX_sCLOCK_TxBitClkGen__16BIT_D1_REG EQU CYREG_B1_UDB09_10_D1
UART_1_BUART_sTX_sCLOCK_TxBitClkGen__16BIT_DP_AUX_CTL_REG EQU CYREG_B1_UDB09_10_ACTL
UART_1_BUART_sTX_sCLOCK_TxBitClkGen__16BIT_F0_REG EQU CYREG_B1_UDB09_10_F0
UART_1_BUART_sTX_sCLOCK_TxBitClkGen__16BIT_F1_REG EQU CYREG_B1_UDB09_10_F1
UART_1_BUART_sTX_sCLOCK_TxBitClkGen__A0_A1_REG EQU CYREG_B1_UDB09_A0_A1
UART_1_BUART_sTX_sCLOCK_TxBitClkGen__A0_REG EQU CYREG_B1_UDB09_A0
UART_1_BUART_sTX_sCLOCK_TxBitClkGen__A1_REG EQU CYREG_B1_UDB09_A1
UART_1_BUART_sTX_sCLOCK_TxBitClkGen__D0_D1_REG EQU CYREG_B1_UDB09_D0_D1
UART_1_BUART_sTX_sCLOCK_TxBitClkGen__D0_REG EQU CYREG_B1_UDB09_D0
UART_1_BUART_sTX_sCLOCK_TxBitClkGen__D1_REG EQU CYREG_B1_UDB09_D1
UART_1_BUART_sTX_sCLOCK_TxBitClkGen__DP_AUX_CTL_REG EQU CYREG_B1_UDB09_ACTL
UART_1_BUART_sTX_sCLOCK_TxBitClkGen__F0_F1_REG EQU CYREG_B1_UDB09_F0_F1
UART_1_BUART_sTX_sCLOCK_TxBitClkGen__F0_REG EQU CYREG_B1_UDB09_F0
UART_1_BUART_sTX_sCLOCK_TxBitClkGen__F1_REG EQU CYREG_B1_UDB09_F1

; Hall_sensor
Hall_sensor__0__MASK EQU 0x01
Hall_sensor__0__PC EQU CYREG_PRT5_PC0
Hall_sensor__0__PORT EQU 5
Hall_sensor__0__SHIFT EQU 0
Hall_sensor__AG EQU CYREG_PRT5_AG
Hall_sensor__AMUX EQU CYREG_PRT5_AMUX
Hall_sensor__BIE EQU CYREG_PRT5_BIE
Hall_sensor__BIT_MASK EQU CYREG_PRT5_BIT_MASK
Hall_sensor__BYP EQU CYREG_PRT5_BYP
Hall_sensor__CTL EQU CYREG_PRT5_CTL
Hall_sensor__DM0 EQU CYREG_PRT5_DM0
Hall_sensor__DM1 EQU CYREG_PRT5_DM1
Hall_sensor__DM2 EQU CYREG_PRT5_DM2
Hall_sensor__DR EQU CYREG_PRT5_DR
Hall_sensor__INP_DIS EQU CYREG_PRT5_INP_DIS
Hall_sensor__LCD_COM_SEG EQU CYREG_PRT5_LCD_COM_SEG
Hall_sensor__LCD_EN EQU CYREG_PRT5_LCD_EN
Hall_sensor__MASK EQU 0x01
Hall_sensor__PORT EQU 5
Hall_sensor__PRT EQU CYREG_PRT5_PRT
Hall_sensor__PRTDSI__CAPS_SEL EQU CYREG_PRT5_CAPS_SEL
Hall_sensor__PRTDSI__DBL_SYNC_IN EQU CYREG_PRT5_DBL_SYNC_IN
Hall_sensor__PRTDSI__OE_SEL0 EQU CYREG_PRT5_OE_SEL0
Hall_sensor__PRTDSI__OE_SEL1 EQU CYREG_PRT5_OE_SEL1
Hall_sensor__PRTDSI__OUT_SEL0 EQU CYREG_PRT5_OUT_SEL0
Hall_sensor__PRTDSI__OUT_SEL1 EQU CYREG_PRT5_OUT_SEL1
Hall_sensor__PRTDSI__SYNC_OUT EQU CYREG_PRT5_SYNC_OUT
Hall_sensor__PS EQU CYREG_PRT5_PS
Hall_sensor__SHIFT EQU 0
Hall_sensor__SLW EQU CYREG_PRT5_SLW

; LCD_LCDPort
LCD_LCDPort__0__MASK EQU 0x01
LCD_LCDPort__0__PC EQU CYREG_PRT2_PC0
LCD_LCDPort__0__PORT EQU 2
LCD_LCDPort__0__SHIFT EQU 0
LCD_LCDPort__1__MASK EQU 0x02
LCD_LCDPort__1__PC EQU CYREG_PRT2_PC1
LCD_LCDPort__1__PORT EQU 2
LCD_LCDPort__1__SHIFT EQU 1
LCD_LCDPort__2__MASK EQU 0x04
LCD_LCDPort__2__PC EQU CYREG_PRT2_PC2
LCD_LCDPort__2__PORT EQU 2
LCD_LCDPort__2__SHIFT EQU 2
LCD_LCDPort__3__MASK EQU 0x08
LCD_LCDPort__3__PC EQU CYREG_PRT2_PC3
LCD_LCDPort__3__PORT EQU 2
LCD_LCDPort__3__SHIFT EQU 3
LCD_LCDPort__4__MASK EQU 0x10
LCD_LCDPort__4__PC EQU CYREG_PRT2_PC4
LCD_LCDPort__4__PORT EQU 2
LCD_LCDPort__4__SHIFT EQU 4
LCD_LCDPort__5__MASK EQU 0x20
LCD_LCDPort__5__PC EQU CYREG_PRT2_PC5
LCD_LCDPort__5__PORT EQU 2
LCD_LCDPort__5__SHIFT EQU 5
LCD_LCDPort__6__MASK EQU 0x40
LCD_LCDPort__6__PC EQU CYREG_PRT2_PC6
LCD_LCDPort__6__PORT EQU 2
LCD_LCDPort__6__SHIFT EQU 6
LCD_LCDPort__AG EQU CYREG_PRT2_AG
LCD_LCDPort__AMUX EQU CYREG_PRT2_AMUX
LCD_LCDPort__BIE EQU CYREG_PRT2_BIE
LCD_LCDPort__BIT_MASK EQU CYREG_PRT2_BIT_MASK
LCD_LCDPort__BYP EQU CYREG_PRT2_BYP
LCD_LCDPort__CTL EQU CYREG_PRT2_CTL
LCD_LCDPort__DM0 EQU CYREG_PRT2_DM0
LCD_LCDPort__DM1 EQU CYREG_PRT2_DM1
LCD_LCDPort__DM2 EQU CYREG_PRT2_DM2
LCD_LCDPort__DR EQU CYREG_PRT2_DR
LCD_LCDPort__INP_DIS EQU CYREG_PRT2_INP_DIS
LCD_LCDPort__LCD_COM_SEG EQU CYREG_PRT2_LCD_COM_SEG
LCD_LCDPort__LCD_EN EQU CYREG_PRT2_LCD_EN
LCD_LCDPort__MASK EQU 0x7F
LCD_LCDPort__PORT EQU 2
LCD_LCDPort__PRT EQU CYREG_PRT2_PRT
LCD_LCDPort__PRTDSI__CAPS_SEL EQU CYREG_PRT2_CAPS_SEL
LCD_LCDPort__PRTDSI__DBL_SYNC_IN EQU CYREG_PRT2_DBL_SYNC_IN
LCD_LCDPort__PRTDSI__OE_SEL0 EQU CYREG_PRT2_OE_SEL0
LCD_LCDPort__PRTDSI__OE_SEL1 EQU CYREG_PRT2_OE_SEL1
LCD_LCDPort__PRTDSI__OUT_SEL0 EQU CYREG_PRT2_OUT_SEL0
LCD_LCDPort__PRTDSI__OUT_SEL1 EQU CYREG_PRT2_OUT_SEL1
LCD_LCDPort__PRTDSI__SYNC_OUT EQU CYREG_PRT2_SYNC_OUT
LCD_LCDPort__PS EQU CYREG_PRT2_PS
LCD_LCDPort__SHIFT EQU 0
LCD_LCDPort__SLW EQU CYREG_PRT2_SLW

; Pin_button
Pin_button__0__MASK EQU 0x02
Pin_button__0__PC EQU CYREG_PRT6_PC1
Pin_button__0__PORT EQU 6
Pin_button__0__SHIFT EQU 1
Pin_button__AG EQU CYREG_PRT6_AG
Pin_button__AMUX EQU CYREG_PRT6_AMUX
Pin_button__BIE EQU CYREG_PRT6_BIE
Pin_button__BIT_MASK EQU CYREG_PRT6_BIT_MASK
Pin_button__BYP EQU CYREG_PRT6_BYP
Pin_button__CTL EQU CYREG_PRT6_CTL
Pin_button__DM0 EQU CYREG_PRT6_DM0
Pin_button__DM1 EQU CYREG_PRT6_DM1
Pin_button__DM2 EQU CYREG_PRT6_DM2
Pin_button__DR EQU CYREG_PRT6_DR
Pin_button__INP_DIS EQU CYREG_PRT6_INP_DIS
Pin_button__LCD_COM_SEG EQU CYREG_PRT6_LCD_COM_SEG
Pin_button__LCD_EN EQU CYREG_PRT6_LCD_EN
Pin_button__MASK EQU 0x02
Pin_button__PORT EQU 6
Pin_button__PRT EQU CYREG_PRT6_PRT
Pin_button__PRTDSI__CAPS_SEL EQU CYREG_PRT6_CAPS_SEL
Pin_button__PRTDSI__DBL_SYNC_IN EQU CYREG_PRT6_DBL_SYNC_IN
Pin_button__PRTDSI__OE_SEL0 EQU CYREG_PRT6_OE_SEL0
Pin_button__PRTDSI__OE_SEL1 EQU CYREG_PRT6_OE_SEL1
Pin_button__PRTDSI__OUT_SEL0 EQU CYREG_PRT6_OUT_SEL0
Pin_button__PRTDSI__OUT_SEL1 EQU CYREG_PRT6_OUT_SEL1
Pin_button__PRTDSI__SYNC_OUT EQU CYREG_PRT6_SYNC_OUT
Pin_button__PS EQU CYREG_PRT6_PS
Pin_button__SHIFT EQU 1
Pin_button__SLW EQU CYREG_PRT6_SLW

; PWM_PWMUDB
PWM_PWMUDB_sCTRLReg_SyncCtl_ctrlreg__16BIT_CONTROL_AUX_CTL_REG EQU CYREG_B0_UDB07_08_ACTL
PWM_PWMUDB_sCTRLReg_SyncCtl_ctrlreg__16BIT_CONTROL_CONTROL_REG EQU CYREG_B0_UDB07_08_CTL
PWM_PWMUDB_sCTRLReg_SyncCtl_ctrlreg__16BIT_CONTROL_COUNT_REG EQU CYREG_B0_UDB07_08_CTL
PWM_PWMUDB_sCTRLReg_SyncCtl_ctrlreg__16BIT_COUNT_CONTROL_REG EQU CYREG_B0_UDB07_08_CTL
PWM_PWMUDB_sCTRLReg_SyncCtl_ctrlreg__16BIT_COUNT_COUNT_REG EQU CYREG_B0_UDB07_08_CTL
PWM_PWMUDB_sCTRLReg_SyncCtl_ctrlreg__16BIT_MASK_MASK_REG EQU CYREG_B0_UDB07_08_MSK
PWM_PWMUDB_sCTRLReg_SyncCtl_ctrlreg__16BIT_MASK_PERIOD_REG EQU CYREG_B0_UDB07_08_MSK
PWM_PWMUDB_sCTRLReg_SyncCtl_ctrlreg__16BIT_PERIOD_MASK_REG EQU CYREG_B0_UDB07_08_MSK
PWM_PWMUDB_sCTRLReg_SyncCtl_ctrlreg__16BIT_PERIOD_PERIOD_REG EQU CYREG_B0_UDB07_08_MSK
PWM_PWMUDB_sCTRLReg_SyncCtl_ctrlreg__7__MASK EQU 0x80
PWM_PWMUDB_sCTRLReg_SyncCtl_ctrlreg__7__POS EQU 7
PWM_PWMUDB_sCTRLReg_SyncCtl_ctrlreg__CONTROL_AUX_CTL_REG EQU CYREG_B0_UDB07_ACTL
PWM_PWMUDB_sCTRLReg_SyncCtl_ctrlreg__CONTROL_REG EQU CYREG_B0_UDB07_CTL
PWM_PWMUDB_sCTRLReg_SyncCtl_ctrlreg__CONTROL_ST_REG EQU CYREG_B0_UDB07_ST_CTL
PWM_PWMUDB_sCTRLReg_SyncCtl_ctrlreg__COUNT_REG EQU CYREG_B0_UDB07_CTL
PWM_PWMUDB_sCTRLReg_SyncCtl_ctrlreg__COUNT_ST_REG EQU CYREG_B0_UDB07_ST_CTL
PWM_PWMUDB_sCTRLReg_SyncCtl_ctrlreg__MASK EQU 0x80
PWM_PWMUDB_sCTRLReg_SyncCtl_ctrlreg__MASK_CTL_AUX_CTL_REG EQU CYREG_B0_UDB07_MSK_ACTL
PWM_PWMUDB_sCTRLReg_SyncCtl_ctrlreg__PERIOD_REG EQU CYREG_B0_UDB07_MSK
PWM_PWMUDB_sCTRLReg_SyncCtl_ctrlreg__PER_CTL_AUX_CTL_REG EQU CYREG_B0_UDB07_MSK_ACTL
PWM_PWMUDB_sP16_pwmdp_u0__16BIT_A0_REG EQU CYREG_B0_UDB06_07_A0
PWM_PWMUDB_sP16_pwmdp_u0__16BIT_A1_REG EQU CYREG_B0_UDB06_07_A1
PWM_PWMUDB_sP16_pwmdp_u0__16BIT_D0_REG EQU CYREG_B0_UDB06_07_D0
PWM_PWMUDB_sP16_pwmdp_u0__16BIT_D1_REG EQU CYREG_B0_UDB06_07_D1
PWM_PWMUDB_sP16_pwmdp_u0__16BIT_DP_AUX_CTL_REG EQU CYREG_B0_UDB06_07_ACTL
PWM_PWMUDB_sP16_pwmdp_u0__16BIT_F0_REG EQU CYREG_B0_UDB06_07_F0
PWM_PWMUDB_sP16_pwmdp_u0__16BIT_F1_REG EQU CYREG_B0_UDB06_07_F1
PWM_PWMUDB_sP16_pwmdp_u0__A0_A1_REG EQU CYREG_B0_UDB06_A0_A1
PWM_PWMUDB_sP16_pwmdp_u0__A0_REG EQU CYREG_B0_UDB06_A0
PWM_PWMUDB_sP16_pwmdp_u0__A1_REG EQU CYREG_B0_UDB06_A1
PWM_PWMUDB_sP16_pwmdp_u0__D0_D1_REG EQU CYREG_B0_UDB06_D0_D1
PWM_PWMUDB_sP16_pwmdp_u0__D0_REG EQU CYREG_B0_UDB06_D0
PWM_PWMUDB_sP16_pwmdp_u0__D1_REG EQU CYREG_B0_UDB06_D1
PWM_PWMUDB_sP16_pwmdp_u0__DP_AUX_CTL_REG EQU CYREG_B0_UDB06_ACTL
PWM_PWMUDB_sP16_pwmdp_u0__F0_F1_REG EQU CYREG_B0_UDB06_F0_F1
PWM_PWMUDB_sP16_pwmdp_u0__F0_REG EQU CYREG_B0_UDB06_F0
PWM_PWMUDB_sP16_pwmdp_u0__F1_REG EQU CYREG_B0_UDB06_F1
PWM_PWMUDB_sP16_pwmdp_u1__16BIT_A0_REG EQU CYREG_B0_UDB07_08_A0
PWM_PWMUDB_sP16_pwmdp_u1__16BIT_A1_REG EQU CYREG_B0_UDB07_08_A1
PWM_PWMUDB_sP16_pwmdp_u1__16BIT_D0_REG EQU CYREG_B0_UDB07_08_D0
PWM_PWMUDB_sP16_pwmdp_u1__16BIT_D1_REG EQU CYREG_B0_UDB07_08_D1
PWM_PWMUDB_sP16_pwmdp_u1__16BIT_DP_AUX_CTL_REG EQU CYREG_B0_UDB07_08_ACTL
PWM_PWMUDB_sP16_pwmdp_u1__16BIT_F0_REG EQU CYREG_B0_UDB07_08_F0
PWM_PWMUDB_sP16_pwmdp_u1__16BIT_F1_REG EQU CYREG_B0_UDB07_08_F1
PWM_PWMUDB_sP16_pwmdp_u1__A0_A1_REG EQU CYREG_B0_UDB07_A0_A1
PWM_PWMUDB_sP16_pwmdp_u1__A0_REG EQU CYREG_B0_UDB07_A0
PWM_PWMUDB_sP16_pwmdp_u1__A1_REG EQU CYREG_B0_UDB07_A1
PWM_PWMUDB_sP16_pwmdp_u1__D0_D1_REG EQU CYREG_B0_UDB07_D0_D1
PWM_PWMUDB_sP16_pwmdp_u1__D0_REG EQU CYREG_B0_UDB07_D0
PWM_PWMUDB_sP16_pwmdp_u1__D1_REG EQU CYREG_B0_UDB07_D1
PWM_PWMUDB_sP16_pwmdp_u1__DP_AUX_CTL_REG EQU CYREG_B0_UDB07_ACTL
PWM_PWMUDB_sP16_pwmdp_u1__F0_F1_REG EQU CYREG_B0_UDB07_F0_F1
PWM_PWMUDB_sP16_pwmdp_u1__F0_REG EQU CYREG_B0_UDB07_F0
PWM_PWMUDB_sP16_pwmdp_u1__F1_REG EQU CYREG_B0_UDB07_F1
PWM_PWMUDB_sP16_pwmdp_u1__MSK_DP_AUX_CTL_REG EQU CYREG_B0_UDB07_MSK_ACTL
PWM_PWMUDB_sP16_pwmdp_u1__PER_DP_AUX_CTL_REG EQU CYREG_B0_UDB07_MSK_ACTL
PWM_PWMUDB_sSTSReg_rstSts_stsreg__0__MASK EQU 0x01
PWM_PWMUDB_sSTSReg_rstSts_stsreg__0__POS EQU 0
PWM_PWMUDB_sSTSReg_rstSts_stsreg__16BIT_STATUS_AUX_CTL_REG EQU CYREG_B0_UDB07_08_ACTL
PWM_PWMUDB_sSTSReg_rstSts_stsreg__16BIT_STATUS_REG EQU CYREG_B0_UDB07_08_ST
PWM_PWMUDB_sSTSReg_rstSts_stsreg__2__MASK EQU 0x04
PWM_PWMUDB_sSTSReg_rstSts_stsreg__2__POS EQU 2
PWM_PWMUDB_sSTSReg_rstSts_stsreg__3__MASK EQU 0x08
PWM_PWMUDB_sSTSReg_rstSts_stsreg__3__POS EQU 3
PWM_PWMUDB_sSTSReg_rstSts_stsreg__5__MASK EQU 0x20
PWM_PWMUDB_sSTSReg_rstSts_stsreg__5__POS EQU 5
PWM_PWMUDB_sSTSReg_rstSts_stsreg__MASK EQU 0x2D
PWM_PWMUDB_sSTSReg_rstSts_stsreg__MASK_REG EQU CYREG_B0_UDB07_MSK
PWM_PWMUDB_sSTSReg_rstSts_stsreg__MASK_ST_AUX_CTL_REG EQU CYREG_B0_UDB07_MSK_ACTL
PWM_PWMUDB_sSTSReg_rstSts_stsreg__PER_ST_AUX_CTL_REG EQU CYREG_B0_UDB07_MSK_ACTL
PWM_PWMUDB_sSTSReg_rstSts_stsreg__STATUS_AUX_CTL_REG EQU CYREG_B0_UDB07_ACTL
PWM_PWMUDB_sSTSReg_rstSts_stsreg__STATUS_CNT_REG EQU CYREG_B0_UDB07_ST_CTL
PWM_PWMUDB_sSTSReg_rstSts_stsreg__STATUS_CONTROL_REG EQU CYREG_B0_UDB07_ST_CTL
PWM_PWMUDB_sSTSReg_rstSts_stsreg__STATUS_REG EQU CYREG_B0_UDB07_ST

; wheel_tick
wheel_tick__INTC_CLR_EN_REG EQU CYREG_NVIC_CLRENA0
wheel_tick__INTC_CLR_PD_REG EQU CYREG_NVIC_CLRPEND0
wheel_tick__INTC_MASK EQU 0x08
wheel_tick__INTC_NUMBER EQU 3
wheel_tick__INTC_PRIOR_NUM EQU 7
wheel_tick__INTC_PRIOR_REG EQU CYREG_NVIC_PRI_3
wheel_tick__INTC_SET_EN_REG EQU CYREG_NVIC_SETENA0
wheel_tick__INTC_SET_PD_REG EQU CYREG_NVIC_SETPEND0

; Pin_motor
Pin_motor__0__MASK EQU 0x02
Pin_motor__0__PC EQU CYREG_PRT4_PC1
Pin_motor__0__PORT EQU 4
Pin_motor__0__SHIFT EQU 1
Pin_motor__AG EQU CYREG_PRT4_AG
Pin_motor__AMUX EQU CYREG_PRT4_AMUX
Pin_motor__BIE EQU CYREG_PRT4_BIE
Pin_motor__BIT_MASK EQU CYREG_PRT4_BIT_MASK
Pin_motor__BYP EQU CYREG_PRT4_BYP
Pin_motor__CTL EQU CYREG_PRT4_CTL
Pin_motor__DM0 EQU CYREG_PRT4_DM0
Pin_motor__DM1 EQU CYREG_PRT4_DM1
Pin_motor__DM2 EQU CYREG_PRT4_DM2
Pin_motor__DR EQU CYREG_PRT4_DR
Pin_motor__INP_DIS EQU CYREG_PRT4_INP_DIS
Pin_motor__LCD_COM_SEG EQU CYREG_PRT4_LCD_COM_SEG
Pin_motor__LCD_EN EQU CYREG_PRT4_LCD_EN
Pin_motor__MASK EQU 0x02
Pin_motor__PORT EQU 4
Pin_motor__PRT EQU CYREG_PRT4_PRT
Pin_motor__PRTDSI__CAPS_SEL EQU CYREG_PRT4_CAPS_SEL
Pin_motor__PRTDSI__DBL_SYNC_IN EQU CYREG_PRT4_DBL_SYNC_IN
Pin_motor__PRTDSI__OE_SEL0 EQU CYREG_PRT4_OE_SEL0
Pin_motor__PRTDSI__OE_SEL1 EQU CYREG_PRT4_OE_SEL1
Pin_motor__PRTDSI__OUT_SEL0 EQU CYREG_PRT4_OUT_SEL0
Pin_motor__PRTDSI__OUT_SEL1 EQU CYREG_PRT4_OUT_SEL1
Pin_motor__PRTDSI__SYNC_OUT EQU CYREG_PRT4_SYNC_OUT
Pin_motor__PS EQU CYREG_PRT4_PS
Pin_motor__SHIFT EQU 1
Pin_motor__SLW EQU CYREG_PRT4_SLW

; Clock_1
Clock_1__CFG0 EQU CYREG_CLKDIST_DCFG1_CFG0
Clock_1__CFG1 EQU CYREG_CLKDIST_DCFG1_CFG1
Clock_1__CFG2 EQU CYREG_CLKDIST_DCFG1_CFG2
Clock_1__CFG2_SRC_SEL_MASK EQU 0x07
Clock_1__INDEX EQU 0x01
Clock_1__PM_ACT_CFG EQU CYREG_PM_ACT_CFG2
Clock_1__PM_ACT_MSK EQU 0x02
Clock_1__PM_STBY_CFG EQU CYREG_PM_STBY_CFG2
Clock_1__PM_STBY_MSK EQU 0x02

; rx_rcvd
rx_rcvd__INTC_CLR_EN_REG EQU CYREG_NVIC_CLRENA0
rx_rcvd__INTC_CLR_PD_REG EQU CYREG_NVIC_CLRPEND0
rx_rcvd__INTC_MASK EQU 0x02
rx_rcvd__INTC_NUMBER EQU 1
rx_rcvd__INTC_PRIOR_NUM EQU 7
rx_rcvd__INTC_PRIOR_REG EQU CYREG_NVIC_PRI_1
rx_rcvd__INTC_SET_EN_REG EQU CYREG_NVIC_SETENA0
rx_rcvd__INTC_SET_PD_REG EQU CYREG_NVIC_SETPEND0

; Rx_1
Rx_1__0__MASK EQU 0x01
Rx_1__0__PC EQU CYREG_PRT3_PC0
Rx_1__0__PORT EQU 3
Rx_1__0__SHIFT EQU 0
Rx_1__AG EQU CYREG_PRT3_AG
Rx_1__AMUX EQU CYREG_PRT3_AMUX
Rx_1__BIE EQU CYREG_PRT3_BIE
Rx_1__BIT_MASK EQU CYREG_PRT3_BIT_MASK
Rx_1__BYP EQU CYREG_PRT3_BYP
Rx_1__CTL EQU CYREG_PRT3_CTL
Rx_1__DM0 EQU CYREG_PRT3_DM0
Rx_1__DM1 EQU CYREG_PRT3_DM1
Rx_1__DM2 EQU CYREG_PRT3_DM2
Rx_1__DR EQU CYREG_PRT3_DR
Rx_1__INP_DIS EQU CYREG_PRT3_INP_DIS
Rx_1__LCD_COM_SEG EQU CYREG_PRT3_LCD_COM_SEG
Rx_1__LCD_EN EQU CYREG_PRT3_LCD_EN
Rx_1__MASK EQU 0x01
Rx_1__PORT EQU 3
Rx_1__PRT EQU CYREG_PRT3_PRT
Rx_1__PRTDSI__CAPS_SEL EQU CYREG_PRT3_CAPS_SEL
Rx_1__PRTDSI__DBL_SYNC_IN EQU CYREG_PRT3_DBL_SYNC_IN
Rx_1__PRTDSI__OE_SEL0 EQU CYREG_PRT3_OE_SEL0
Rx_1__PRTDSI__OE_SEL1 EQU CYREG_PRT3_OE_SEL1
Rx_1__PRTDSI__OUT_SEL0 EQU CYREG_PRT3_OUT_SEL0
Rx_1__PRTDSI__OUT_SEL1 EQU CYREG_PRT3_OUT_SEL1
Rx_1__PRTDSI__SYNC_OUT EQU CYREG_PRT3_SYNC_OUT
Rx_1__PS EQU CYREG_PRT3_PS
Rx_1__SHIFT EQU 0
Rx_1__SLW EQU CYREG_PRT3_SLW

; Tx_1
Tx_1__0__MASK EQU 0x02
Tx_1__0__PC EQU CYREG_PRT3_PC1
Tx_1__0__PORT EQU 3
Tx_1__0__SHIFT EQU 1
Tx_1__AG EQU CYREG_PRT3_AG
Tx_1__AMUX EQU CYREG_PRT3_AMUX
Tx_1__BIE EQU CYREG_PRT3_BIE
Tx_1__BIT_MASK EQU CYREG_PRT3_BIT_MASK
Tx_1__BYP EQU CYREG_PRT3_BYP
Tx_1__CTL EQU CYREG_PRT3_CTL
Tx_1__DM0 EQU CYREG_PRT3_DM0
Tx_1__DM1 EQU CYREG_PRT3_DM1
Tx_1__DM2 EQU CYREG_PRT3_DM2
Tx_1__DR EQU CYREG_PRT3_DR
Tx_1__INP_DIS EQU CYREG_PRT3_INP_DIS
Tx_1__LCD_COM_SEG EQU CYREG_PRT3_LCD_COM_SEG
Tx_1__LCD_EN EQU CYREG_PRT3_LCD_EN
Tx_1__MASK EQU 0x02
Tx_1__PORT EQU 3
Tx_1__PRT EQU CYREG_PRT3_PRT
Tx_1__PRTDSI__CAPS_SEL EQU CYREG_PRT3_CAPS_SEL
Tx_1__PRTDSI__DBL_SYNC_IN EQU CYREG_PRT3_DBL_SYNC_IN
Tx_1__PRTDSI__OE_SEL0 EQU CYREG_PRT3_OE_SEL0
Tx_1__PRTDSI__OE_SEL1 EQU CYREG_PRT3_OE_SEL1
Tx_1__PRTDSI__OUT_SEL0 EQU CYREG_PRT3_OUT_SEL0
Tx_1__PRTDSI__OUT_SEL1 EQU CYREG_PRT3_OUT_SEL1
Tx_1__PRTDSI__SYNC_OUT EQU CYREG_PRT3_SYNC_OUT
Tx_1__PS EQU CYREG_PRT3_PS
Tx_1__SHIFT EQU 1
Tx_1__SLW EQU CYREG_PRT3_SLW

; Miscellaneous
; -- WARNING: define names containing LEOPARD or PANTHER are deprecated and will be removed in a future release
CYDEV_DEBUGGING_DPS_SWD_SWV EQU 6
CYDEV_CONFIG_UNUSED_IO_AllowButWarn EQU 0
CYDEV_CONFIGURATION_MODE_COMPRESSED EQU 0
CYDEV_CONFIG_FASTBOOT_ENABLED EQU 1
CYDEV_CHIP_REV_PSOC5LP_PRODUCTION EQU 0
CYDEV_CHIP_REVISION_5B_PRODUCTION EQU 0
CYDEV_CHIP_MEMBER_5B EQU 3
CYDEV_CHIP_FAMILY_PSOC5 EQU 3
CYDEV_CHIP_DIE_PSOC5LP EQU 3
CYDEV_CHIP_DIE_EXPECT EQU CYDEV_CHIP_DIE_PSOC5LP
BCLK__BUS_CLK__HZ EQU 24000000
BCLK__BUS_CLK__KHZ EQU 24000
BCLK__BUS_CLK__MHZ EQU 24
CYDEV_CHIP_DIE_ACTUAL EQU CYDEV_CHIP_DIE_EXPECT
CYDEV_CHIP_DIE_LEOPARD EQU 1
CYDEV_CHIP_DIE_PANTHER EQU 2
CYDEV_CHIP_DIE_UNKNOWN EQU 0
CYDEV_CHIP_FAMILY_PSOC3 EQU 1
CYDEV_CHIP_FAMILY_PSOC4 EQU 2
CYDEV_CHIP_FAMILY_UNKNOWN EQU 0
CYDEV_CHIP_FAMILY_USED EQU CYDEV_CHIP_FAMILY_PSOC5
CYDEV_CHIP_JTAG_ID EQU 0x2E123069
CYDEV_CHIP_MEMBER_3A EQU 1
CYDEV_CHIP_MEMBER_5A EQU 2
CYDEV_CHIP_MEMBER_UNKNOWN EQU 0
CYDEV_CHIP_MEMBER_USED EQU CYDEV_CHIP_MEMBER_5B
CYDEV_CHIP_REVISION_3A_ES1 EQU 0
CYDEV_CHIP_REVISION_3A_ES2 EQU 1
CYDEV_CHIP_REVISION_3A_ES3 EQU 3
CYDEV_CHIP_REVISION_3A_PRODUCTION EQU 3
CYDEV_CHIP_REVISION_5A_ES0 EQU 0
CYDEV_CHIP_REVISION_5A_ES1 EQU 1
CYDEV_CHIP_REVISION_5A_PRODUCTION EQU 1
CYDEV_CHIP_REVISION_5B_ES EQU 0
CYDEV_CHIP_REVISION_USED EQU CYDEV_CHIP_REVISION_5B_PRODUCTION
CYDEV_CHIP_REV_EXPECT EQU CYDEV_CHIP_REV_PSOC5LP_PRODUCTION
CYDEV_CHIP_REV_LEOPARD_ES1 EQU 0
CYDEV_CHIP_REV_LEOPARD_ES2 EQU 1
CYDEV_CHIP_REV_LEOPARD_ES3 EQU 3
CYDEV_CHIP_REV_LEOPARD_PRODUCTION EQU 3
CYDEV_CHIP_REV_PANTHER_ES0 EQU 0
CYDEV_CHIP_REV_PANTHER_ES1 EQU 1
CYDEV_CHIP_REV_PANTHER_PRODUCTION EQU 1
CYDEV_CHIP_REV_PSOC5LP_ES EQU 0
CYDEV_CONFIGURATION_COMPRESSED EQU 1
CYDEV_CONFIGURATION_DMA EQU 0
CYDEV_CONFIGURATION_ECC EQU 1
CYDEV_CONFIGURATION_IMOENABLED EQU CYDEV_CONFIG_FASTBOOT_ENABLED
CYDEV_CONFIGURATION_MODE EQU CYDEV_CONFIGURATION_MODE_COMPRESSED
CYDEV_CONFIGURATION_MODE_DMA EQU 2
CYDEV_CONFIGURATION_MODE_UNCOMPRESSED EQU 1
CYDEV_CONFIG_FORCE_ROUTE EQU 0
CYDEV_CONFIG_UNUSED_IO EQU CYDEV_CONFIG_UNUSED_IO_AllowButWarn
CYDEV_CONFIG_UNUSED_IO_AllowWithInfo EQU 1
CYDEV_CONFIG_UNUSED_IO_Disallowed EQU 2
CYDEV_DEBUGGING_DPS EQU CYDEV_DEBUGGING_DPS_SWD_SWV
CYDEV_DEBUGGING_DPS_Disable EQU 3
CYDEV_DEBUGGING_DPS_JTAG_4 EQU 1
CYDEV_DEBUGGING_DPS_JTAG_5 EQU 0
CYDEV_DEBUGGING_DPS_SWD EQU 2
CYDEV_DEBUGGING_ENABLE EQU 1
CYDEV_DEBUGGING_REQXRES EQU 1
CYDEV_DEBUGGING_XRES EQU 0
CYDEV_DEBUG_ENABLE_MASK EQU 0x20
CYDEV_DEBUG_ENABLE_REGISTER EQU CYREG_MLOGIC_DEBUG
CYDEV_DMA_CHANNELS_AVAILABLE EQU 24
CYDEV_ECC_ENABLE EQU 0
CYDEV_HEAP_SIZE EQU 0x1000
CYDEV_INSTRUCT_CACHE_ENABLED EQU 1
CYDEV_PROJ_TYPE EQU 0
CYDEV_PROJ_TYPE_BOOTLOADER EQU 1
CYDEV_PROJ_TYPE_LOADABLE EQU 2
CYDEV_PROJ_TYPE_MULTIAPPBOOTLOADER EQU 3
CYDEV_PROJ_TYPE_STANDARD EQU 0
CYDEV_PROTECTION_ENABLE EQU 0
CYDEV_STACK_SIZE EQU 0x4000
CYDEV_VDDA_MV EQU 5000
CYDEV_VDDD_MV EQU 5000
CYDEV_VDDIO0_MV EQU 5000
CYDEV_VDDIO1_MV EQU 5000
CYDEV_VDDIO2_MV EQU 5000
CYDEV_VDDIO3_MV EQU 5000
CYDEV_VIO0 EQU 5
CYDEV_VIO0_MV EQU 5000
CYDEV_VIO1 EQU 5
CYDEV_VIO1_MV EQU 5000
CYDEV_VIO2 EQU 5
CYDEV_VIO2_MV EQU 5000
CYDEV_VIO3 EQU 5
CYDEV_VIO3_MV EQU 5000
DMA_CHANNELS_USED__MASK0 EQU 0x00000000
CYDEV_BOOTLOADER_ENABLE EQU 0
    ENDIF
    END
