.ifndef INCLUDED_CYFITTERGNU_INC
.set INCLUDED_CYFITTERGNU_INC, 1
.include "cydevicegnu.inc"
.include "cydevicegnu_trm.inc"

/* Counter_1_CounterHW */
.set Counter_1_CounterHW__CAP0, CYREG_TMR0_CAP0
.set Counter_1_CounterHW__CAP1, CYREG_TMR0_CAP1
.set Counter_1_CounterHW__CFG0, CYREG_TMR0_CFG0
.set Counter_1_CounterHW__CFG1, CYREG_TMR0_CFG1
.set Counter_1_CounterHW__CFG2, CYREG_TMR0_CFG2
.set Counter_1_CounterHW__CNT_CMP0, CYREG_TMR0_CNT_CMP0
.set Counter_1_CounterHW__CNT_CMP1, CYREG_TMR0_CNT_CMP1
.set Counter_1_CounterHW__PER0, CYREG_TMR0_PER0
.set Counter_1_CounterHW__PER1, CYREG_TMR0_PER1
.set Counter_1_CounterHW__PM_ACT_CFG, CYREG_PM_ACT_CFG3
.set Counter_1_CounterHW__PM_ACT_MSK, 0x01
.set Counter_1_CounterHW__PM_STBY_CFG, CYREG_PM_STBY_CFG3
.set Counter_1_CounterHW__PM_STBY_MSK, 0x01
.set Counter_1_CounterHW__RT0, CYREG_TMR0_RT0
.set Counter_1_CounterHW__RT1, CYREG_TMR0_RT1
.set Counter_1_CounterHW__SR0, CYREG_TMR0_SR0

/* Counter_2_CounterHW */
.set Counter_2_CounterHW__CAP0, CYREG_TMR1_CAP0
.set Counter_2_CounterHW__CAP1, CYREG_TMR1_CAP1
.set Counter_2_CounterHW__CFG0, CYREG_TMR1_CFG0
.set Counter_2_CounterHW__CFG1, CYREG_TMR1_CFG1
.set Counter_2_CounterHW__CFG2, CYREG_TMR1_CFG2
.set Counter_2_CounterHW__CNT_CMP0, CYREG_TMR1_CNT_CMP0
.set Counter_2_CounterHW__CNT_CMP1, CYREG_TMR1_CNT_CMP1
.set Counter_2_CounterHW__PER0, CYREG_TMR1_PER0
.set Counter_2_CounterHW__PER1, CYREG_TMR1_PER1
.set Counter_2_CounterHW__PM_ACT_CFG, CYREG_PM_ACT_CFG3
.set Counter_2_CounterHW__PM_ACT_MSK, 0x02
.set Counter_2_CounterHW__PM_STBY_CFG, CYREG_PM_STBY_CFG3
.set Counter_2_CounterHW__PM_STBY_MSK, 0x02
.set Counter_2_CounterHW__RT0, CYREG_TMR1_RT0
.set Counter_2_CounterHW__RT1, CYREG_TMR1_RT1
.set Counter_2_CounterHW__SR0, CYREG_TMR1_SR0

/* throttle_update */
.set throttle_update__INTC_CLR_EN_REG, CYREG_NVIC_CLRENA0
.set throttle_update__INTC_CLR_PD_REG, CYREG_NVIC_CLRPEND0
.set throttle_update__INTC_MASK, 0x20000
.set throttle_update__INTC_NUMBER, 17
.set throttle_update__INTC_PRIOR_NUM, 7
.set throttle_update__INTC_PRIOR_REG, CYREG_NVIC_PRI_17
.set throttle_update__INTC_SET_EN_REG, CYREG_NVIC_SETENA0
.set throttle_update__INTC_SET_PD_REG, CYREG_NVIC_SETPEND0

/* Timer_1_TimerHW */
.set Timer_1_TimerHW__CAP0, CYREG_TMR2_CAP0
.set Timer_1_TimerHW__CAP1, CYREG_TMR2_CAP1
.set Timer_1_TimerHW__CFG0, CYREG_TMR2_CFG0
.set Timer_1_TimerHW__CFG1, CYREG_TMR2_CFG1
.set Timer_1_TimerHW__CFG2, CYREG_TMR2_CFG2
.set Timer_1_TimerHW__CNT_CMP0, CYREG_TMR2_CNT_CMP0
.set Timer_1_TimerHW__CNT_CMP1, CYREG_TMR2_CNT_CMP1
.set Timer_1_TimerHW__PER0, CYREG_TMR2_PER0
.set Timer_1_TimerHW__PER1, CYREG_TMR2_PER1
.set Timer_1_TimerHW__PM_ACT_CFG, CYREG_PM_ACT_CFG3
.set Timer_1_TimerHW__PM_ACT_MSK, 0x04
.set Timer_1_TimerHW__PM_STBY_CFG, CYREG_PM_STBY_CFG3
.set Timer_1_TimerHW__PM_STBY_MSK, 0x04
.set Timer_1_TimerHW__RT0, CYREG_TMR2_RT0
.set Timer_1_TimerHW__RT1, CYREG_TMR2_RT1
.set Timer_1_TimerHW__SR0, CYREG_TMR2_SR0

/* UART_1_IntClock */
.set UART_1_IntClock__CFG0, CYREG_CLKDIST_DCFG0_CFG0
.set UART_1_IntClock__CFG1, CYREG_CLKDIST_DCFG0_CFG1
.set UART_1_IntClock__CFG2, CYREG_CLKDIST_DCFG0_CFG2
.set UART_1_IntClock__CFG2_SRC_SEL_MASK, 0x07
.set UART_1_IntClock__INDEX, 0x00
.set UART_1_IntClock__PM_ACT_CFG, CYREG_PM_ACT_CFG2
.set UART_1_IntClock__PM_ACT_MSK, 0x01
.set UART_1_IntClock__PM_STBY_CFG, CYREG_PM_STBY_CFG2
.set UART_1_IntClock__PM_STBY_MSK, 0x01

/* ShiftReg_1_bSR */
.set ShiftReg_1_bSR_StsReg__16BIT_STATUS_AUX_CTL_REG, CYREG_B1_UDB04_05_ACTL
.set ShiftReg_1_bSR_StsReg__16BIT_STATUS_REG, CYREG_B1_UDB04_05_ST
.set ShiftReg_1_bSR_StsReg__3__MASK, 0x08
.set ShiftReg_1_bSR_StsReg__3__POS, 3
.set ShiftReg_1_bSR_StsReg__4__MASK, 0x10
.set ShiftReg_1_bSR_StsReg__4__POS, 4
.set ShiftReg_1_bSR_StsReg__5__MASK, 0x20
.set ShiftReg_1_bSR_StsReg__5__POS, 5
.set ShiftReg_1_bSR_StsReg__6__MASK, 0x40
.set ShiftReg_1_bSR_StsReg__6__POS, 6
.set ShiftReg_1_bSR_StsReg__MASK, 0x78
.set ShiftReg_1_bSR_StsReg__MASK_REG, CYREG_B1_UDB04_MSK
.set ShiftReg_1_bSR_StsReg__MASK_ST_AUX_CTL_REG, CYREG_B1_UDB04_MSK_ACTL
.set ShiftReg_1_bSR_StsReg__PER_ST_AUX_CTL_REG, CYREG_B1_UDB04_MSK_ACTL
.set ShiftReg_1_bSR_StsReg__STATUS_AUX_CTL_REG, CYREG_B1_UDB04_ACTL
.set ShiftReg_1_bSR_StsReg__STATUS_CNT_REG, CYREG_B1_UDB04_ST_CTL
.set ShiftReg_1_bSR_StsReg__STATUS_CONTROL_REG, CYREG_B1_UDB04_ST_CTL
.set ShiftReg_1_bSR_StsReg__STATUS_REG, CYREG_B1_UDB04_ST
.set ShiftReg_1_bSR_SyncCtl_CtrlReg__0__MASK, 0x01
.set ShiftReg_1_bSR_SyncCtl_CtrlReg__0__POS, 0
.set ShiftReg_1_bSR_SyncCtl_CtrlReg__16BIT_CONTROL_AUX_CTL_REG, CYREG_B1_UDB04_05_ACTL
.set ShiftReg_1_bSR_SyncCtl_CtrlReg__16BIT_CONTROL_CONTROL_REG, CYREG_B1_UDB04_05_CTL
.set ShiftReg_1_bSR_SyncCtl_CtrlReg__16BIT_CONTROL_COUNT_REG, CYREG_B1_UDB04_05_CTL
.set ShiftReg_1_bSR_SyncCtl_CtrlReg__16BIT_COUNT_CONTROL_REG, CYREG_B1_UDB04_05_CTL
.set ShiftReg_1_bSR_SyncCtl_CtrlReg__16BIT_COUNT_COUNT_REG, CYREG_B1_UDB04_05_CTL
.set ShiftReg_1_bSR_SyncCtl_CtrlReg__16BIT_MASK_MASK_REG, CYREG_B1_UDB04_05_MSK
.set ShiftReg_1_bSR_SyncCtl_CtrlReg__16BIT_MASK_PERIOD_REG, CYREG_B1_UDB04_05_MSK
.set ShiftReg_1_bSR_SyncCtl_CtrlReg__16BIT_PERIOD_MASK_REG, CYREG_B1_UDB04_05_MSK
.set ShiftReg_1_bSR_SyncCtl_CtrlReg__16BIT_PERIOD_PERIOD_REG, CYREG_B1_UDB04_05_MSK
.set ShiftReg_1_bSR_SyncCtl_CtrlReg__CONTROL_AUX_CTL_REG, CYREG_B1_UDB04_ACTL
.set ShiftReg_1_bSR_SyncCtl_CtrlReg__CONTROL_REG, CYREG_B1_UDB04_CTL
.set ShiftReg_1_bSR_SyncCtl_CtrlReg__CONTROL_ST_REG, CYREG_B1_UDB04_ST_CTL
.set ShiftReg_1_bSR_SyncCtl_CtrlReg__COUNT_REG, CYREG_B1_UDB04_CTL
.set ShiftReg_1_bSR_SyncCtl_CtrlReg__COUNT_ST_REG, CYREG_B1_UDB04_ST_CTL
.set ShiftReg_1_bSR_SyncCtl_CtrlReg__MASK, 0x01
.set ShiftReg_1_bSR_SyncCtl_CtrlReg__MASK_CTL_AUX_CTL_REG, CYREG_B1_UDB04_MSK_ACTL
.set ShiftReg_1_bSR_SyncCtl_CtrlReg__PERIOD_REG, CYREG_B1_UDB04_MSK
.set ShiftReg_1_bSR_SyncCtl_CtrlReg__PER_CTL_AUX_CTL_REG, CYREG_B1_UDB04_MSK_ACTL
.set ShiftReg_1_bSR_sC8_BShiftRegDp_u0__16BIT_A0_REG, CYREG_B1_UDB04_05_A0
.set ShiftReg_1_bSR_sC8_BShiftRegDp_u0__16BIT_A1_REG, CYREG_B1_UDB04_05_A1
.set ShiftReg_1_bSR_sC8_BShiftRegDp_u0__16BIT_D0_REG, CYREG_B1_UDB04_05_D0
.set ShiftReg_1_bSR_sC8_BShiftRegDp_u0__16BIT_D1_REG, CYREG_B1_UDB04_05_D1
.set ShiftReg_1_bSR_sC8_BShiftRegDp_u0__16BIT_DP_AUX_CTL_REG, CYREG_B1_UDB04_05_ACTL
.set ShiftReg_1_bSR_sC8_BShiftRegDp_u0__16BIT_F0_REG, CYREG_B1_UDB04_05_F0
.set ShiftReg_1_bSR_sC8_BShiftRegDp_u0__16BIT_F1_REG, CYREG_B1_UDB04_05_F1
.set ShiftReg_1_bSR_sC8_BShiftRegDp_u0__A0_A1_REG, CYREG_B1_UDB04_A0_A1
.set ShiftReg_1_bSR_sC8_BShiftRegDp_u0__A0_REG, CYREG_B1_UDB04_A0
.set ShiftReg_1_bSR_sC8_BShiftRegDp_u0__A1_REG, CYREG_B1_UDB04_A1
.set ShiftReg_1_bSR_sC8_BShiftRegDp_u0__D0_D1_REG, CYREG_B1_UDB04_D0_D1
.set ShiftReg_1_bSR_sC8_BShiftRegDp_u0__D0_REG, CYREG_B1_UDB04_D0
.set ShiftReg_1_bSR_sC8_BShiftRegDp_u0__D1_REG, CYREG_B1_UDB04_D1
.set ShiftReg_1_bSR_sC8_BShiftRegDp_u0__DP_AUX_CTL_REG, CYREG_B1_UDB04_ACTL
.set ShiftReg_1_bSR_sC8_BShiftRegDp_u0__F0_F1_REG, CYREG_B1_UDB04_F0_F1
.set ShiftReg_1_bSR_sC8_BShiftRegDp_u0__F0_REG, CYREG_B1_UDB04_F0
.set ShiftReg_1_bSR_sC8_BShiftRegDp_u0__F1_REG, CYREG_B1_UDB04_F1
.set ShiftReg_1_bSR_sC8_BShiftRegDp_u0__MSK_DP_AUX_CTL_REG, CYREG_B1_UDB04_MSK_ACTL
.set ShiftReg_1_bSR_sC8_BShiftRegDp_u0__PER_DP_AUX_CTL_REG, CYREG_B1_UDB04_MSK_ACTL

/* inter_button */
.set inter_button__INTC_CLR_EN_REG, CYREG_NVIC_CLRENA0
.set inter_button__INTC_CLR_PD_REG, CYREG_NVIC_CLRPEND0
.set inter_button__INTC_MASK, 0x01
.set inter_button__INTC_NUMBER, 0
.set inter_button__INTC_PRIOR_NUM, 7
.set inter_button__INTC_PRIOR_REG, CYREG_NVIC_PRI_0
.set inter_button__INTC_SET_EN_REG, CYREG_NVIC_SETENA0
.set inter_button__INTC_SET_PD_REG, CYREG_NVIC_SETPEND0

/* tick_timeout */
.set tick_timeout__INTC_CLR_EN_REG, CYREG_NVIC_CLRENA0
.set tick_timeout__INTC_CLR_PD_REG, CYREG_NVIC_CLRPEND0
.set tick_timeout__INTC_MASK, 0x04
.set tick_timeout__INTC_NUMBER, 2
.set tick_timeout__INTC_PRIOR_NUM, 7
.set tick_timeout__INTC_PRIOR_REG, CYREG_NVIC_PRI_2
.set tick_timeout__INTC_SET_EN_REG, CYREG_NVIC_SETENA0
.set tick_timeout__INTC_SET_PD_REG, CYREG_NVIC_SETPEND0

/* UART_1_BUART */
.set UART_1_BUART_sRX_RxBitCounter_ST__16BIT_STATUS_AUX_CTL_REG, CYREG_B1_UDB07_08_ACTL
.set UART_1_BUART_sRX_RxBitCounter_ST__16BIT_STATUS_REG, CYREG_B1_UDB07_08_ST
.set UART_1_BUART_sRX_RxBitCounter_ST__MASK_REG, CYREG_B1_UDB07_MSK
.set UART_1_BUART_sRX_RxBitCounter_ST__MASK_ST_AUX_CTL_REG, CYREG_B1_UDB07_MSK_ACTL
.set UART_1_BUART_sRX_RxBitCounter_ST__PER_ST_AUX_CTL_REG, CYREG_B1_UDB07_MSK_ACTL
.set UART_1_BUART_sRX_RxBitCounter_ST__STATUS_AUX_CTL_REG, CYREG_B1_UDB07_ACTL
.set UART_1_BUART_sRX_RxBitCounter_ST__STATUS_CNT_REG, CYREG_B1_UDB07_ST_CTL
.set UART_1_BUART_sRX_RxBitCounter_ST__STATUS_CONTROL_REG, CYREG_B1_UDB07_ST_CTL
.set UART_1_BUART_sRX_RxBitCounter_ST__STATUS_REG, CYREG_B1_UDB07_ST
.set UART_1_BUART_sRX_RxBitCounter__16BIT_CONTROL_AUX_CTL_REG, CYREG_B1_UDB07_08_ACTL
.set UART_1_BUART_sRX_RxBitCounter__16BIT_CONTROL_CONTROL_REG, CYREG_B1_UDB07_08_CTL
.set UART_1_BUART_sRX_RxBitCounter__16BIT_CONTROL_COUNT_REG, CYREG_B1_UDB07_08_CTL
.set UART_1_BUART_sRX_RxBitCounter__16BIT_COUNT_CONTROL_REG, CYREG_B1_UDB07_08_CTL
.set UART_1_BUART_sRX_RxBitCounter__16BIT_COUNT_COUNT_REG, CYREG_B1_UDB07_08_CTL
.set UART_1_BUART_sRX_RxBitCounter__16BIT_MASK_MASK_REG, CYREG_B1_UDB07_08_MSK
.set UART_1_BUART_sRX_RxBitCounter__16BIT_MASK_PERIOD_REG, CYREG_B1_UDB07_08_MSK
.set UART_1_BUART_sRX_RxBitCounter__16BIT_PERIOD_MASK_REG, CYREG_B1_UDB07_08_MSK
.set UART_1_BUART_sRX_RxBitCounter__16BIT_PERIOD_PERIOD_REG, CYREG_B1_UDB07_08_MSK
.set UART_1_BUART_sRX_RxBitCounter__CONTROL_AUX_CTL_REG, CYREG_B1_UDB07_ACTL
.set UART_1_BUART_sRX_RxBitCounter__CONTROL_REG, CYREG_B1_UDB07_CTL
.set UART_1_BUART_sRX_RxBitCounter__CONTROL_ST_REG, CYREG_B1_UDB07_ST_CTL
.set UART_1_BUART_sRX_RxBitCounter__COUNT_REG, CYREG_B1_UDB07_CTL
.set UART_1_BUART_sRX_RxBitCounter__COUNT_ST_REG, CYREG_B1_UDB07_ST_CTL
.set UART_1_BUART_sRX_RxBitCounter__MASK_CTL_AUX_CTL_REG, CYREG_B1_UDB07_MSK_ACTL
.set UART_1_BUART_sRX_RxBitCounter__PERIOD_REG, CYREG_B1_UDB07_MSK
.set UART_1_BUART_sRX_RxBitCounter__PER_CTL_AUX_CTL_REG, CYREG_B1_UDB07_MSK_ACTL
.set UART_1_BUART_sRX_RxShifter_u0__16BIT_A0_REG, CYREG_B1_UDB07_08_A0
.set UART_1_BUART_sRX_RxShifter_u0__16BIT_A1_REG, CYREG_B1_UDB07_08_A1
.set UART_1_BUART_sRX_RxShifter_u0__16BIT_D0_REG, CYREG_B1_UDB07_08_D0
.set UART_1_BUART_sRX_RxShifter_u0__16BIT_D1_REG, CYREG_B1_UDB07_08_D1
.set UART_1_BUART_sRX_RxShifter_u0__16BIT_DP_AUX_CTL_REG, CYREG_B1_UDB07_08_ACTL
.set UART_1_BUART_sRX_RxShifter_u0__16BIT_F0_REG, CYREG_B1_UDB07_08_F0
.set UART_1_BUART_sRX_RxShifter_u0__16BIT_F1_REG, CYREG_B1_UDB07_08_F1
.set UART_1_BUART_sRX_RxShifter_u0__A0_A1_REG, CYREG_B1_UDB07_A0_A1
.set UART_1_BUART_sRX_RxShifter_u0__A0_REG, CYREG_B1_UDB07_A0
.set UART_1_BUART_sRX_RxShifter_u0__A1_REG, CYREG_B1_UDB07_A1
.set UART_1_BUART_sRX_RxShifter_u0__D0_D1_REG, CYREG_B1_UDB07_D0_D1
.set UART_1_BUART_sRX_RxShifter_u0__D0_REG, CYREG_B1_UDB07_D0
.set UART_1_BUART_sRX_RxShifter_u0__D1_REG, CYREG_B1_UDB07_D1
.set UART_1_BUART_sRX_RxShifter_u0__DP_AUX_CTL_REG, CYREG_B1_UDB07_ACTL
.set UART_1_BUART_sRX_RxShifter_u0__F0_F1_REG, CYREG_B1_UDB07_F0_F1
.set UART_1_BUART_sRX_RxShifter_u0__F0_REG, CYREG_B1_UDB07_F0
.set UART_1_BUART_sRX_RxShifter_u0__F1_REG, CYREG_B1_UDB07_F1
.set UART_1_BUART_sRX_RxShifter_u0__MSK_DP_AUX_CTL_REG, CYREG_B1_UDB07_MSK_ACTL
.set UART_1_BUART_sRX_RxShifter_u0__PER_DP_AUX_CTL_REG, CYREG_B1_UDB07_MSK_ACTL
.set UART_1_BUART_sRX_RxSts__16BIT_STATUS_AUX_CTL_REG, CYREG_B0_UDB07_08_ACTL
.set UART_1_BUART_sRX_RxSts__16BIT_STATUS_REG, CYREG_B0_UDB07_08_ST
.set UART_1_BUART_sRX_RxSts__3__MASK, 0x08
.set UART_1_BUART_sRX_RxSts__3__POS, 3
.set UART_1_BUART_sRX_RxSts__4__MASK, 0x10
.set UART_1_BUART_sRX_RxSts__4__POS, 4
.set UART_1_BUART_sRX_RxSts__5__MASK, 0x20
.set UART_1_BUART_sRX_RxSts__5__POS, 5
.set UART_1_BUART_sRX_RxSts__MASK, 0x38
.set UART_1_BUART_sRX_RxSts__MASK_REG, CYREG_B0_UDB07_MSK
.set UART_1_BUART_sRX_RxSts__STATUS_AUX_CTL_REG, CYREG_B0_UDB07_ACTL
.set UART_1_BUART_sRX_RxSts__STATUS_REG, CYREG_B0_UDB07_ST
.set UART_1_BUART_sTX_TxShifter_u0__16BIT_A0_REG, CYREG_B0_UDB07_08_A0
.set UART_1_BUART_sTX_TxShifter_u0__16BIT_A1_REG, CYREG_B0_UDB07_08_A1
.set UART_1_BUART_sTX_TxShifter_u0__16BIT_D0_REG, CYREG_B0_UDB07_08_D0
.set UART_1_BUART_sTX_TxShifter_u0__16BIT_D1_REG, CYREG_B0_UDB07_08_D1
.set UART_1_BUART_sTX_TxShifter_u0__16BIT_DP_AUX_CTL_REG, CYREG_B0_UDB07_08_ACTL
.set UART_1_BUART_sTX_TxShifter_u0__16BIT_F0_REG, CYREG_B0_UDB07_08_F0
.set UART_1_BUART_sTX_TxShifter_u0__16BIT_F1_REG, CYREG_B0_UDB07_08_F1
.set UART_1_BUART_sTX_TxShifter_u0__A0_A1_REG, CYREG_B0_UDB07_A0_A1
.set UART_1_BUART_sTX_TxShifter_u0__A0_REG, CYREG_B0_UDB07_A0
.set UART_1_BUART_sTX_TxShifter_u0__A1_REG, CYREG_B0_UDB07_A1
.set UART_1_BUART_sTX_TxShifter_u0__D0_D1_REG, CYREG_B0_UDB07_D0_D1
.set UART_1_BUART_sTX_TxShifter_u0__D0_REG, CYREG_B0_UDB07_D0
.set UART_1_BUART_sTX_TxShifter_u0__D1_REG, CYREG_B0_UDB07_D1
.set UART_1_BUART_sTX_TxShifter_u0__DP_AUX_CTL_REG, CYREG_B0_UDB07_ACTL
.set UART_1_BUART_sTX_TxShifter_u0__F0_F1_REG, CYREG_B0_UDB07_F0_F1
.set UART_1_BUART_sTX_TxShifter_u0__F0_REG, CYREG_B0_UDB07_F0
.set UART_1_BUART_sTX_TxShifter_u0__F1_REG, CYREG_B0_UDB07_F1
.set UART_1_BUART_sTX_TxSts__0__MASK, 0x01
.set UART_1_BUART_sTX_TxSts__0__POS, 0
.set UART_1_BUART_sTX_TxSts__16BIT_STATUS_AUX_CTL_REG, CYREG_B0_UDB04_05_ACTL
.set UART_1_BUART_sTX_TxSts__16BIT_STATUS_REG, CYREG_B0_UDB04_05_ST
.set UART_1_BUART_sTX_TxSts__1__MASK, 0x02
.set UART_1_BUART_sTX_TxSts__1__POS, 1
.set UART_1_BUART_sTX_TxSts__2__MASK, 0x04
.set UART_1_BUART_sTX_TxSts__2__POS, 2
.set UART_1_BUART_sTX_TxSts__3__MASK, 0x08
.set UART_1_BUART_sTX_TxSts__3__POS, 3
.set UART_1_BUART_sTX_TxSts__MASK, 0x0F
.set UART_1_BUART_sTX_TxSts__MASK_REG, CYREG_B0_UDB04_MSK
.set UART_1_BUART_sTX_TxSts__STATUS_AUX_CTL_REG, CYREG_B0_UDB04_ACTL
.set UART_1_BUART_sTX_TxSts__STATUS_REG, CYREG_B0_UDB04_ST
.set UART_1_BUART_sTX_sCLOCK_TxBitClkGen__16BIT_A0_REG, CYREG_B1_UDB06_07_A0
.set UART_1_BUART_sTX_sCLOCK_TxBitClkGen__16BIT_A1_REG, CYREG_B1_UDB06_07_A1
.set UART_1_BUART_sTX_sCLOCK_TxBitClkGen__16BIT_D0_REG, CYREG_B1_UDB06_07_D0
.set UART_1_BUART_sTX_sCLOCK_TxBitClkGen__16BIT_D1_REG, CYREG_B1_UDB06_07_D1
.set UART_1_BUART_sTX_sCLOCK_TxBitClkGen__16BIT_DP_AUX_CTL_REG, CYREG_B1_UDB06_07_ACTL
.set UART_1_BUART_sTX_sCLOCK_TxBitClkGen__16BIT_F0_REG, CYREG_B1_UDB06_07_F0
.set UART_1_BUART_sTX_sCLOCK_TxBitClkGen__16BIT_F1_REG, CYREG_B1_UDB06_07_F1
.set UART_1_BUART_sTX_sCLOCK_TxBitClkGen__A0_A1_REG, CYREG_B1_UDB06_A0_A1
.set UART_1_BUART_sTX_sCLOCK_TxBitClkGen__A0_REG, CYREG_B1_UDB06_A0
.set UART_1_BUART_sTX_sCLOCK_TxBitClkGen__A1_REG, CYREG_B1_UDB06_A1
.set UART_1_BUART_sTX_sCLOCK_TxBitClkGen__D0_D1_REG, CYREG_B1_UDB06_D0_D1
.set UART_1_BUART_sTX_sCLOCK_TxBitClkGen__D0_REG, CYREG_B1_UDB06_D0
.set UART_1_BUART_sTX_sCLOCK_TxBitClkGen__D1_REG, CYREG_B1_UDB06_D1
.set UART_1_BUART_sTX_sCLOCK_TxBitClkGen__DP_AUX_CTL_REG, CYREG_B1_UDB06_ACTL
.set UART_1_BUART_sTX_sCLOCK_TxBitClkGen__F0_F1_REG, CYREG_B1_UDB06_F0_F1
.set UART_1_BUART_sTX_sCLOCK_TxBitClkGen__F0_REG, CYREG_B1_UDB06_F0
.set UART_1_BUART_sTX_sCLOCK_TxBitClkGen__F1_REG, CYREG_B1_UDB06_F1

/* Hall_sensor */
.set Hall_sensor__0__MASK, 0x01
.set Hall_sensor__0__PC, CYREG_PRT5_PC0
.set Hall_sensor__0__PORT, 5
.set Hall_sensor__0__SHIFT, 0
.set Hall_sensor__AG, CYREG_PRT5_AG
.set Hall_sensor__AMUX, CYREG_PRT5_AMUX
.set Hall_sensor__BIE, CYREG_PRT5_BIE
.set Hall_sensor__BIT_MASK, CYREG_PRT5_BIT_MASK
.set Hall_sensor__BYP, CYREG_PRT5_BYP
.set Hall_sensor__CTL, CYREG_PRT5_CTL
.set Hall_sensor__DM0, CYREG_PRT5_DM0
.set Hall_sensor__DM1, CYREG_PRT5_DM1
.set Hall_sensor__DM2, CYREG_PRT5_DM2
.set Hall_sensor__DR, CYREG_PRT5_DR
.set Hall_sensor__INP_DIS, CYREG_PRT5_INP_DIS
.set Hall_sensor__LCD_COM_SEG, CYREG_PRT5_LCD_COM_SEG
.set Hall_sensor__LCD_EN, CYREG_PRT5_LCD_EN
.set Hall_sensor__MASK, 0x01
.set Hall_sensor__PORT, 5
.set Hall_sensor__PRT, CYREG_PRT5_PRT
.set Hall_sensor__PRTDSI__CAPS_SEL, CYREG_PRT5_CAPS_SEL
.set Hall_sensor__PRTDSI__DBL_SYNC_IN, CYREG_PRT5_DBL_SYNC_IN
.set Hall_sensor__PRTDSI__OE_SEL0, CYREG_PRT5_OE_SEL0
.set Hall_sensor__PRTDSI__OE_SEL1, CYREG_PRT5_OE_SEL1
.set Hall_sensor__PRTDSI__OUT_SEL0, CYREG_PRT5_OUT_SEL0
.set Hall_sensor__PRTDSI__OUT_SEL1, CYREG_PRT5_OUT_SEL1
.set Hall_sensor__PRTDSI__SYNC_OUT, CYREG_PRT5_SYNC_OUT
.set Hall_sensor__PS, CYREG_PRT5_PS
.set Hall_sensor__SHIFT, 0
.set Hall_sensor__SLW, CYREG_PRT5_SLW

/* LCD_LCDPort */
.set LCD_LCDPort__0__MASK, 0x01
.set LCD_LCDPort__0__PC, CYREG_PRT2_PC0
.set LCD_LCDPort__0__PORT, 2
.set LCD_LCDPort__0__SHIFT, 0
.set LCD_LCDPort__1__MASK, 0x02
.set LCD_LCDPort__1__PC, CYREG_PRT2_PC1
.set LCD_LCDPort__1__PORT, 2
.set LCD_LCDPort__1__SHIFT, 1
.set LCD_LCDPort__2__MASK, 0x04
.set LCD_LCDPort__2__PC, CYREG_PRT2_PC2
.set LCD_LCDPort__2__PORT, 2
.set LCD_LCDPort__2__SHIFT, 2
.set LCD_LCDPort__3__MASK, 0x08
.set LCD_LCDPort__3__PC, CYREG_PRT2_PC3
.set LCD_LCDPort__3__PORT, 2
.set LCD_LCDPort__3__SHIFT, 3
.set LCD_LCDPort__4__MASK, 0x10
.set LCD_LCDPort__4__PC, CYREG_PRT2_PC4
.set LCD_LCDPort__4__PORT, 2
.set LCD_LCDPort__4__SHIFT, 4
.set LCD_LCDPort__5__MASK, 0x20
.set LCD_LCDPort__5__PC, CYREG_PRT2_PC5
.set LCD_LCDPort__5__PORT, 2
.set LCD_LCDPort__5__SHIFT, 5
.set LCD_LCDPort__6__MASK, 0x40
.set LCD_LCDPort__6__PC, CYREG_PRT2_PC6
.set LCD_LCDPort__6__PORT, 2
.set LCD_LCDPort__6__SHIFT, 6
.set LCD_LCDPort__AG, CYREG_PRT2_AG
.set LCD_LCDPort__AMUX, CYREG_PRT2_AMUX
.set LCD_LCDPort__BIE, CYREG_PRT2_BIE
.set LCD_LCDPort__BIT_MASK, CYREG_PRT2_BIT_MASK
.set LCD_LCDPort__BYP, CYREG_PRT2_BYP
.set LCD_LCDPort__CTL, CYREG_PRT2_CTL
.set LCD_LCDPort__DM0, CYREG_PRT2_DM0
.set LCD_LCDPort__DM1, CYREG_PRT2_DM1
.set LCD_LCDPort__DM2, CYREG_PRT2_DM2
.set LCD_LCDPort__DR, CYREG_PRT2_DR
.set LCD_LCDPort__INP_DIS, CYREG_PRT2_INP_DIS
.set LCD_LCDPort__LCD_COM_SEG, CYREG_PRT2_LCD_COM_SEG
.set LCD_LCDPort__LCD_EN, CYREG_PRT2_LCD_EN
.set LCD_LCDPort__MASK, 0x7F
.set LCD_LCDPort__PORT, 2
.set LCD_LCDPort__PRT, CYREG_PRT2_PRT
.set LCD_LCDPort__PRTDSI__CAPS_SEL, CYREG_PRT2_CAPS_SEL
.set LCD_LCDPort__PRTDSI__DBL_SYNC_IN, CYREG_PRT2_DBL_SYNC_IN
.set LCD_LCDPort__PRTDSI__OE_SEL0, CYREG_PRT2_OE_SEL0
.set LCD_LCDPort__PRTDSI__OE_SEL1, CYREG_PRT2_OE_SEL1
.set LCD_LCDPort__PRTDSI__OUT_SEL0, CYREG_PRT2_OUT_SEL0
.set LCD_LCDPort__PRTDSI__OUT_SEL1, CYREG_PRT2_OUT_SEL1
.set LCD_LCDPort__PRTDSI__SYNC_OUT, CYREG_PRT2_SYNC_OUT
.set LCD_LCDPort__PS, CYREG_PRT2_PS
.set LCD_LCDPort__SHIFT, 0
.set LCD_LCDPort__SLW, CYREG_PRT2_SLW

/* Pin_button */
.set Pin_button__0__MASK, 0x02
.set Pin_button__0__PC, CYREG_PRT6_PC1
.set Pin_button__0__PORT, 6
.set Pin_button__0__SHIFT, 1
.set Pin_button__AG, CYREG_PRT6_AG
.set Pin_button__AMUX, CYREG_PRT6_AMUX
.set Pin_button__BIE, CYREG_PRT6_BIE
.set Pin_button__BIT_MASK, CYREG_PRT6_BIT_MASK
.set Pin_button__BYP, CYREG_PRT6_BYP
.set Pin_button__CTL, CYREG_PRT6_CTL
.set Pin_button__DM0, CYREG_PRT6_DM0
.set Pin_button__DM1, CYREG_PRT6_DM1
.set Pin_button__DM2, CYREG_PRT6_DM2
.set Pin_button__DR, CYREG_PRT6_DR
.set Pin_button__INP_DIS, CYREG_PRT6_INP_DIS
.set Pin_button__LCD_COM_SEG, CYREG_PRT6_LCD_COM_SEG
.set Pin_button__LCD_EN, CYREG_PRT6_LCD_EN
.set Pin_button__MASK, 0x02
.set Pin_button__PORT, 6
.set Pin_button__PRT, CYREG_PRT6_PRT
.set Pin_button__PRTDSI__CAPS_SEL, CYREG_PRT6_CAPS_SEL
.set Pin_button__PRTDSI__DBL_SYNC_IN, CYREG_PRT6_DBL_SYNC_IN
.set Pin_button__PRTDSI__OE_SEL0, CYREG_PRT6_OE_SEL0
.set Pin_button__PRTDSI__OE_SEL1, CYREG_PRT6_OE_SEL1
.set Pin_button__PRTDSI__OUT_SEL0, CYREG_PRT6_OUT_SEL0
.set Pin_button__PRTDSI__OUT_SEL1, CYREG_PRT6_OUT_SEL1
.set Pin_button__PRTDSI__SYNC_OUT, CYREG_PRT6_SYNC_OUT
.set Pin_button__PS, CYREG_PRT6_PS
.set Pin_button__SHIFT, 1
.set Pin_button__SLW, CYREG_PRT6_SLW

/* PWM_PWMUDB */
.set PWM_PWMUDB_sCTRLReg_SyncCtl_ctrlreg__16BIT_CONTROL_AUX_CTL_REG, CYREG_B0_UDB05_06_ACTL
.set PWM_PWMUDB_sCTRLReg_SyncCtl_ctrlreg__16BIT_CONTROL_CONTROL_REG, CYREG_B0_UDB05_06_CTL
.set PWM_PWMUDB_sCTRLReg_SyncCtl_ctrlreg__16BIT_CONTROL_COUNT_REG, CYREG_B0_UDB05_06_CTL
.set PWM_PWMUDB_sCTRLReg_SyncCtl_ctrlreg__16BIT_COUNT_CONTROL_REG, CYREG_B0_UDB05_06_CTL
.set PWM_PWMUDB_sCTRLReg_SyncCtl_ctrlreg__16BIT_COUNT_COUNT_REG, CYREG_B0_UDB05_06_CTL
.set PWM_PWMUDB_sCTRLReg_SyncCtl_ctrlreg__16BIT_MASK_MASK_REG, CYREG_B0_UDB05_06_MSK
.set PWM_PWMUDB_sCTRLReg_SyncCtl_ctrlreg__16BIT_MASK_PERIOD_REG, CYREG_B0_UDB05_06_MSK
.set PWM_PWMUDB_sCTRLReg_SyncCtl_ctrlreg__16BIT_PERIOD_MASK_REG, CYREG_B0_UDB05_06_MSK
.set PWM_PWMUDB_sCTRLReg_SyncCtl_ctrlreg__16BIT_PERIOD_PERIOD_REG, CYREG_B0_UDB05_06_MSK
.set PWM_PWMUDB_sCTRLReg_SyncCtl_ctrlreg__7__MASK, 0x80
.set PWM_PWMUDB_sCTRLReg_SyncCtl_ctrlreg__7__POS, 7
.set PWM_PWMUDB_sCTRLReg_SyncCtl_ctrlreg__CONTROL_AUX_CTL_REG, CYREG_B0_UDB05_ACTL
.set PWM_PWMUDB_sCTRLReg_SyncCtl_ctrlreg__CONTROL_REG, CYREG_B0_UDB05_CTL
.set PWM_PWMUDB_sCTRLReg_SyncCtl_ctrlreg__CONTROL_ST_REG, CYREG_B0_UDB05_ST_CTL
.set PWM_PWMUDB_sCTRLReg_SyncCtl_ctrlreg__COUNT_REG, CYREG_B0_UDB05_CTL
.set PWM_PWMUDB_sCTRLReg_SyncCtl_ctrlreg__COUNT_ST_REG, CYREG_B0_UDB05_ST_CTL
.set PWM_PWMUDB_sCTRLReg_SyncCtl_ctrlreg__MASK, 0x80
.set PWM_PWMUDB_sCTRLReg_SyncCtl_ctrlreg__MASK_CTL_AUX_CTL_REG, CYREG_B0_UDB05_MSK_ACTL
.set PWM_PWMUDB_sCTRLReg_SyncCtl_ctrlreg__PERIOD_REG, CYREG_B0_UDB05_MSK
.set PWM_PWMUDB_sCTRLReg_SyncCtl_ctrlreg__PER_CTL_AUX_CTL_REG, CYREG_B0_UDB05_MSK_ACTL
.set PWM_PWMUDB_sP16_pwmdp_u0__16BIT_A0_REG, CYREG_B0_UDB04_05_A0
.set PWM_PWMUDB_sP16_pwmdp_u0__16BIT_A1_REG, CYREG_B0_UDB04_05_A1
.set PWM_PWMUDB_sP16_pwmdp_u0__16BIT_D0_REG, CYREG_B0_UDB04_05_D0
.set PWM_PWMUDB_sP16_pwmdp_u0__16BIT_D1_REG, CYREG_B0_UDB04_05_D1
.set PWM_PWMUDB_sP16_pwmdp_u0__16BIT_DP_AUX_CTL_REG, CYREG_B0_UDB04_05_ACTL
.set PWM_PWMUDB_sP16_pwmdp_u0__16BIT_F0_REG, CYREG_B0_UDB04_05_F0
.set PWM_PWMUDB_sP16_pwmdp_u0__16BIT_F1_REG, CYREG_B0_UDB04_05_F1
.set PWM_PWMUDB_sP16_pwmdp_u0__A0_A1_REG, CYREG_B0_UDB04_A0_A1
.set PWM_PWMUDB_sP16_pwmdp_u0__A0_REG, CYREG_B0_UDB04_A0
.set PWM_PWMUDB_sP16_pwmdp_u0__A1_REG, CYREG_B0_UDB04_A1
.set PWM_PWMUDB_sP16_pwmdp_u0__D0_D1_REG, CYREG_B0_UDB04_D0_D1
.set PWM_PWMUDB_sP16_pwmdp_u0__D0_REG, CYREG_B0_UDB04_D0
.set PWM_PWMUDB_sP16_pwmdp_u0__D1_REG, CYREG_B0_UDB04_D1
.set PWM_PWMUDB_sP16_pwmdp_u0__DP_AUX_CTL_REG, CYREG_B0_UDB04_ACTL
.set PWM_PWMUDB_sP16_pwmdp_u0__F0_F1_REG, CYREG_B0_UDB04_F0_F1
.set PWM_PWMUDB_sP16_pwmdp_u0__F0_REG, CYREG_B0_UDB04_F0
.set PWM_PWMUDB_sP16_pwmdp_u0__F1_REG, CYREG_B0_UDB04_F1
.set PWM_PWMUDB_sP16_pwmdp_u1__16BIT_A0_REG, CYREG_B0_UDB05_06_A0
.set PWM_PWMUDB_sP16_pwmdp_u1__16BIT_A1_REG, CYREG_B0_UDB05_06_A1
.set PWM_PWMUDB_sP16_pwmdp_u1__16BIT_D0_REG, CYREG_B0_UDB05_06_D0
.set PWM_PWMUDB_sP16_pwmdp_u1__16BIT_D1_REG, CYREG_B0_UDB05_06_D1
.set PWM_PWMUDB_sP16_pwmdp_u1__16BIT_DP_AUX_CTL_REG, CYREG_B0_UDB05_06_ACTL
.set PWM_PWMUDB_sP16_pwmdp_u1__16BIT_F0_REG, CYREG_B0_UDB05_06_F0
.set PWM_PWMUDB_sP16_pwmdp_u1__16BIT_F1_REG, CYREG_B0_UDB05_06_F1
.set PWM_PWMUDB_sP16_pwmdp_u1__A0_A1_REG, CYREG_B0_UDB05_A0_A1
.set PWM_PWMUDB_sP16_pwmdp_u1__A0_REG, CYREG_B0_UDB05_A0
.set PWM_PWMUDB_sP16_pwmdp_u1__A1_REG, CYREG_B0_UDB05_A1
.set PWM_PWMUDB_sP16_pwmdp_u1__D0_D1_REG, CYREG_B0_UDB05_D0_D1
.set PWM_PWMUDB_sP16_pwmdp_u1__D0_REG, CYREG_B0_UDB05_D0
.set PWM_PWMUDB_sP16_pwmdp_u1__D1_REG, CYREG_B0_UDB05_D1
.set PWM_PWMUDB_sP16_pwmdp_u1__DP_AUX_CTL_REG, CYREG_B0_UDB05_ACTL
.set PWM_PWMUDB_sP16_pwmdp_u1__F0_F1_REG, CYREG_B0_UDB05_F0_F1
.set PWM_PWMUDB_sP16_pwmdp_u1__F0_REG, CYREG_B0_UDB05_F0
.set PWM_PWMUDB_sP16_pwmdp_u1__F1_REG, CYREG_B0_UDB05_F1
.set PWM_PWMUDB_sP16_pwmdp_u1__MSK_DP_AUX_CTL_REG, CYREG_B0_UDB05_MSK_ACTL
.set PWM_PWMUDB_sP16_pwmdp_u1__PER_DP_AUX_CTL_REG, CYREG_B0_UDB05_MSK_ACTL
.set PWM_PWMUDB_sSTSReg_rstSts_stsreg__0__MASK, 0x01
.set PWM_PWMUDB_sSTSReg_rstSts_stsreg__0__POS, 0
.set PWM_PWMUDB_sSTSReg_rstSts_stsreg__16BIT_STATUS_AUX_CTL_REG, CYREG_B0_UDB05_06_ACTL
.set PWM_PWMUDB_sSTSReg_rstSts_stsreg__16BIT_STATUS_REG, CYREG_B0_UDB05_06_ST
.set PWM_PWMUDB_sSTSReg_rstSts_stsreg__2__MASK, 0x04
.set PWM_PWMUDB_sSTSReg_rstSts_stsreg__2__POS, 2
.set PWM_PWMUDB_sSTSReg_rstSts_stsreg__3__MASK, 0x08
.set PWM_PWMUDB_sSTSReg_rstSts_stsreg__3__POS, 3
.set PWM_PWMUDB_sSTSReg_rstSts_stsreg__5__MASK, 0x20
.set PWM_PWMUDB_sSTSReg_rstSts_stsreg__5__POS, 5
.set PWM_PWMUDB_sSTSReg_rstSts_stsreg__MASK, 0x2D
.set PWM_PWMUDB_sSTSReg_rstSts_stsreg__MASK_REG, CYREG_B0_UDB05_MSK
.set PWM_PWMUDB_sSTSReg_rstSts_stsreg__MASK_ST_AUX_CTL_REG, CYREG_B0_UDB05_MSK_ACTL
.set PWM_PWMUDB_sSTSReg_rstSts_stsreg__PER_ST_AUX_CTL_REG, CYREG_B0_UDB05_MSK_ACTL
.set PWM_PWMUDB_sSTSReg_rstSts_stsreg__STATUS_AUX_CTL_REG, CYREG_B0_UDB05_ACTL
.set PWM_PWMUDB_sSTSReg_rstSts_stsreg__STATUS_CNT_REG, CYREG_B0_UDB05_ST_CTL
.set PWM_PWMUDB_sSTSReg_rstSts_stsreg__STATUS_CONTROL_REG, CYREG_B0_UDB05_ST_CTL
.set PWM_PWMUDB_sSTSReg_rstSts_stsreg__STATUS_REG, CYREG_B0_UDB05_ST

/* wheel_tick */
.set wheel_tick__INTC_CLR_EN_REG, CYREG_NVIC_CLRENA0
.set wheel_tick__INTC_CLR_PD_REG, CYREG_NVIC_CLRPEND0
.set wheel_tick__INTC_MASK, 0x08
.set wheel_tick__INTC_NUMBER, 3
.set wheel_tick__INTC_PRIOR_NUM, 7
.set wheel_tick__INTC_PRIOR_REG, CYREG_NVIC_PRI_3
.set wheel_tick__INTC_SET_EN_REG, CYREG_NVIC_SETENA0
.set wheel_tick__INTC_SET_PD_REG, CYREG_NVIC_SETPEND0

/* Pin_motor */
.set Pin_motor__0__MASK, 0x02
.set Pin_motor__0__PC, CYREG_PRT4_PC1
.set Pin_motor__0__PORT, 4
.set Pin_motor__0__SHIFT, 1
.set Pin_motor__AG, CYREG_PRT4_AG
.set Pin_motor__AMUX, CYREG_PRT4_AMUX
.set Pin_motor__BIE, CYREG_PRT4_BIE
.set Pin_motor__BIT_MASK, CYREG_PRT4_BIT_MASK
.set Pin_motor__BYP, CYREG_PRT4_BYP
.set Pin_motor__CTL, CYREG_PRT4_CTL
.set Pin_motor__DM0, CYREG_PRT4_DM0
.set Pin_motor__DM1, CYREG_PRT4_DM1
.set Pin_motor__DM2, CYREG_PRT4_DM2
.set Pin_motor__DR, CYREG_PRT4_DR
.set Pin_motor__INP_DIS, CYREG_PRT4_INP_DIS
.set Pin_motor__LCD_COM_SEG, CYREG_PRT4_LCD_COM_SEG
.set Pin_motor__LCD_EN, CYREG_PRT4_LCD_EN
.set Pin_motor__MASK, 0x02
.set Pin_motor__PORT, 4
.set Pin_motor__PRT, CYREG_PRT4_PRT
.set Pin_motor__PRTDSI__CAPS_SEL, CYREG_PRT4_CAPS_SEL
.set Pin_motor__PRTDSI__DBL_SYNC_IN, CYREG_PRT4_DBL_SYNC_IN
.set Pin_motor__PRTDSI__OE_SEL0, CYREG_PRT4_OE_SEL0
.set Pin_motor__PRTDSI__OE_SEL1, CYREG_PRT4_OE_SEL1
.set Pin_motor__PRTDSI__OUT_SEL0, CYREG_PRT4_OUT_SEL0
.set Pin_motor__PRTDSI__OUT_SEL1, CYREG_PRT4_OUT_SEL1
.set Pin_motor__PRTDSI__SYNC_OUT, CYREG_PRT4_SYNC_OUT
.set Pin_motor__PS, CYREG_PRT4_PS
.set Pin_motor__SHIFT, 1
.set Pin_motor__SLW, CYREG_PRT4_SLW

/* Clock_1 */
.set Clock_1__CFG0, CYREG_CLKDIST_DCFG1_CFG0
.set Clock_1__CFG1, CYREG_CLKDIST_DCFG1_CFG1
.set Clock_1__CFG2, CYREG_CLKDIST_DCFG1_CFG2
.set Clock_1__CFG2_SRC_SEL_MASK, 0x07
.set Clock_1__INDEX, 0x01
.set Clock_1__PM_ACT_CFG, CYREG_PM_ACT_CFG2
.set Clock_1__PM_ACT_MSK, 0x02
.set Clock_1__PM_STBY_CFG, CYREG_PM_STBY_CFG2
.set Clock_1__PM_STBY_MSK, 0x02

/* Clock_2 */
.set Clock_2__CFG0, CYREG_CLKDIST_DCFG2_CFG0
.set Clock_2__CFG1, CYREG_CLKDIST_DCFG2_CFG1
.set Clock_2__CFG2, CYREG_CLKDIST_DCFG2_CFG2
.set Clock_2__CFG2_SRC_SEL_MASK, 0x07
.set Clock_2__INDEX, 0x02
.set Clock_2__PM_ACT_CFG, CYREG_PM_ACT_CFG2
.set Clock_2__PM_ACT_MSK, 0x04
.set Clock_2__PM_STBY_CFG, CYREG_PM_STBY_CFG2
.set Clock_2__PM_STBY_MSK, 0x04

/* rx_rcvd */
.set rx_rcvd__INTC_CLR_EN_REG, CYREG_NVIC_CLRENA0
.set rx_rcvd__INTC_CLR_PD_REG, CYREG_NVIC_CLRPEND0
.set rx_rcvd__INTC_MASK, 0x02
.set rx_rcvd__INTC_NUMBER, 1
.set rx_rcvd__INTC_PRIOR_NUM, 7
.set rx_rcvd__INTC_PRIOR_REG, CYREG_NVIC_PRI_1
.set rx_rcvd__INTC_SET_EN_REG, CYREG_NVIC_SETENA0
.set rx_rcvd__INTC_SET_PD_REG, CYREG_NVIC_SETPEND0

/* Rx_1 */
.set Rx_1__0__MASK, 0x01
.set Rx_1__0__PC, CYREG_PRT3_PC0
.set Rx_1__0__PORT, 3
.set Rx_1__0__SHIFT, 0
.set Rx_1__AG, CYREG_PRT3_AG
.set Rx_1__AMUX, CYREG_PRT3_AMUX
.set Rx_1__BIE, CYREG_PRT3_BIE
.set Rx_1__BIT_MASK, CYREG_PRT3_BIT_MASK
.set Rx_1__BYP, CYREG_PRT3_BYP
.set Rx_1__CTL, CYREG_PRT3_CTL
.set Rx_1__DM0, CYREG_PRT3_DM0
.set Rx_1__DM1, CYREG_PRT3_DM1
.set Rx_1__DM2, CYREG_PRT3_DM2
.set Rx_1__DR, CYREG_PRT3_DR
.set Rx_1__INP_DIS, CYREG_PRT3_INP_DIS
.set Rx_1__LCD_COM_SEG, CYREG_PRT3_LCD_COM_SEG
.set Rx_1__LCD_EN, CYREG_PRT3_LCD_EN
.set Rx_1__MASK, 0x01
.set Rx_1__PORT, 3
.set Rx_1__PRT, CYREG_PRT3_PRT
.set Rx_1__PRTDSI__CAPS_SEL, CYREG_PRT3_CAPS_SEL
.set Rx_1__PRTDSI__DBL_SYNC_IN, CYREG_PRT3_DBL_SYNC_IN
.set Rx_1__PRTDSI__OE_SEL0, CYREG_PRT3_OE_SEL0
.set Rx_1__PRTDSI__OE_SEL1, CYREG_PRT3_OE_SEL1
.set Rx_1__PRTDSI__OUT_SEL0, CYREG_PRT3_OUT_SEL0
.set Rx_1__PRTDSI__OUT_SEL1, CYREG_PRT3_OUT_SEL1
.set Rx_1__PRTDSI__SYNC_OUT, CYREG_PRT3_SYNC_OUT
.set Rx_1__PS, CYREG_PRT3_PS
.set Rx_1__SHIFT, 0
.set Rx_1__SLW, CYREG_PRT3_SLW

/* Tx_1 */
.set Tx_1__0__MASK, 0x02
.set Tx_1__0__PC, CYREG_PRT3_PC1
.set Tx_1__0__PORT, 3
.set Tx_1__0__SHIFT, 1
.set Tx_1__AG, CYREG_PRT3_AG
.set Tx_1__AMUX, CYREG_PRT3_AMUX
.set Tx_1__BIE, CYREG_PRT3_BIE
.set Tx_1__BIT_MASK, CYREG_PRT3_BIT_MASK
.set Tx_1__BYP, CYREG_PRT3_BYP
.set Tx_1__CTL, CYREG_PRT3_CTL
.set Tx_1__DM0, CYREG_PRT3_DM0
.set Tx_1__DM1, CYREG_PRT3_DM1
.set Tx_1__DM2, CYREG_PRT3_DM2
.set Tx_1__DR, CYREG_PRT3_DR
.set Tx_1__INP_DIS, CYREG_PRT3_INP_DIS
.set Tx_1__LCD_COM_SEG, CYREG_PRT3_LCD_COM_SEG
.set Tx_1__LCD_EN, CYREG_PRT3_LCD_EN
.set Tx_1__MASK, 0x02
.set Tx_1__PORT, 3
.set Tx_1__PRT, CYREG_PRT3_PRT
.set Tx_1__PRTDSI__CAPS_SEL, CYREG_PRT3_CAPS_SEL
.set Tx_1__PRTDSI__DBL_SYNC_IN, CYREG_PRT3_DBL_SYNC_IN
.set Tx_1__PRTDSI__OE_SEL0, CYREG_PRT3_OE_SEL0
.set Tx_1__PRTDSI__OE_SEL1, CYREG_PRT3_OE_SEL1
.set Tx_1__PRTDSI__OUT_SEL0, CYREG_PRT3_OUT_SEL0
.set Tx_1__PRTDSI__OUT_SEL1, CYREG_PRT3_OUT_SEL1
.set Tx_1__PRTDSI__SYNC_OUT, CYREG_PRT3_SYNC_OUT
.set Tx_1__PS, CYREG_PRT3_PS
.set Tx_1__SHIFT, 1
.set Tx_1__SLW, CYREG_PRT3_SLW

/* Miscellaneous */
/* -- WARNING: define names containing LEOPARD or PANTHER are deprecated and will be removed in a future release */
.set CYDEV_DEBUGGING_DPS_SWD_SWV, 6
.set CYDEV_CONFIG_UNUSED_IO_AllowButWarn, 0
.set CYDEV_CONFIGURATION_MODE_COMPRESSED, 0
.set CYDEV_CONFIG_FASTBOOT_ENABLED, 1
.set CYDEV_CHIP_REV_PSOC5LP_PRODUCTION, 0
.set CYDEV_CHIP_REVISION_5B_PRODUCTION, 0
.set CYDEV_CHIP_MEMBER_5B, 3
.set CYDEV_CHIP_FAMILY_PSOC5, 3
.set CYDEV_CHIP_DIE_PSOC5LP, 3
.set CYDEV_CHIP_DIE_EXPECT, CYDEV_CHIP_DIE_PSOC5LP
.set BCLK__BUS_CLK__HZ, 24000000
.set BCLK__BUS_CLK__KHZ, 24000
.set BCLK__BUS_CLK__MHZ, 24
.set CYDEV_CHIP_DIE_ACTUAL, CYDEV_CHIP_DIE_EXPECT
.set CYDEV_CHIP_DIE_LEOPARD, 1
.set CYDEV_CHIP_DIE_PANTHER, 2
.set CYDEV_CHIP_DIE_UNKNOWN, 0
.set CYDEV_CHIP_FAMILY_PSOC3, 1
.set CYDEV_CHIP_FAMILY_PSOC4, 2
.set CYDEV_CHIP_FAMILY_UNKNOWN, 0
.set CYDEV_CHIP_FAMILY_USED, CYDEV_CHIP_FAMILY_PSOC5
.set CYDEV_CHIP_JTAG_ID, 0x2E123069
.set CYDEV_CHIP_MEMBER_3A, 1
.set CYDEV_CHIP_MEMBER_5A, 2
.set CYDEV_CHIP_MEMBER_UNKNOWN, 0
.set CYDEV_CHIP_MEMBER_USED, CYDEV_CHIP_MEMBER_5B
.set CYDEV_CHIP_REVISION_3A_ES1, 0
.set CYDEV_CHIP_REVISION_3A_ES2, 1
.set CYDEV_CHIP_REVISION_3A_ES3, 3
.set CYDEV_CHIP_REVISION_3A_PRODUCTION, 3
.set CYDEV_CHIP_REVISION_5A_ES0, 0
.set CYDEV_CHIP_REVISION_5A_ES1, 1
.set CYDEV_CHIP_REVISION_5A_PRODUCTION, 1
.set CYDEV_CHIP_REVISION_5B_ES, 0
.set CYDEV_CHIP_REVISION_USED, CYDEV_CHIP_REVISION_5B_PRODUCTION
.set CYDEV_CHIP_REV_EXPECT, CYDEV_CHIP_REV_PSOC5LP_PRODUCTION
.set CYDEV_CHIP_REV_LEOPARD_ES1, 0
.set CYDEV_CHIP_REV_LEOPARD_ES2, 1
.set CYDEV_CHIP_REV_LEOPARD_ES3, 3
.set CYDEV_CHIP_REV_LEOPARD_PRODUCTION, 3
.set CYDEV_CHIP_REV_PANTHER_ES0, 0
.set CYDEV_CHIP_REV_PANTHER_ES1, 1
.set CYDEV_CHIP_REV_PANTHER_PRODUCTION, 1
.set CYDEV_CHIP_REV_PSOC5LP_ES, 0
.set CYDEV_CONFIGURATION_COMPRESSED, 1
.set CYDEV_CONFIGURATION_DMA, 0
.set CYDEV_CONFIGURATION_ECC, 1
.set CYDEV_CONFIGURATION_IMOENABLED, CYDEV_CONFIG_FASTBOOT_ENABLED
.set CYDEV_CONFIGURATION_MODE, CYDEV_CONFIGURATION_MODE_COMPRESSED
.set CYDEV_CONFIGURATION_MODE_DMA, 2
.set CYDEV_CONFIGURATION_MODE_UNCOMPRESSED, 1
.set CYDEV_CONFIG_FORCE_ROUTE, 0
.set CYDEV_CONFIG_UNUSED_IO, CYDEV_CONFIG_UNUSED_IO_AllowButWarn
.set CYDEV_CONFIG_UNUSED_IO_AllowWithInfo, 1
.set CYDEV_CONFIG_UNUSED_IO_Disallowed, 2
.set CYDEV_DEBUGGING_DPS, CYDEV_DEBUGGING_DPS_SWD_SWV
.set CYDEV_DEBUGGING_DPS_Disable, 3
.set CYDEV_DEBUGGING_DPS_JTAG_4, 1
.set CYDEV_DEBUGGING_DPS_JTAG_5, 0
.set CYDEV_DEBUGGING_DPS_SWD, 2
.set CYDEV_DEBUGGING_ENABLE, 1
.set CYDEV_DEBUGGING_REQXRES, 1
.set CYDEV_DEBUGGING_XRES, 0
.set CYDEV_DEBUG_ENABLE_MASK, 0x20
.set CYDEV_DEBUG_ENABLE_REGISTER, CYREG_MLOGIC_DEBUG
.set CYDEV_DMA_CHANNELS_AVAILABLE, 24
.set CYDEV_ECC_ENABLE, 0
.set CYDEV_HEAP_SIZE, 0x1000
.set CYDEV_INSTRUCT_CACHE_ENABLED, 1
.set CYDEV_PROJ_TYPE, 0
.set CYDEV_PROJ_TYPE_BOOTLOADER, 1
.set CYDEV_PROJ_TYPE_LOADABLE, 2
.set CYDEV_PROJ_TYPE_MULTIAPPBOOTLOADER, 3
.set CYDEV_PROJ_TYPE_STANDARD, 0
.set CYDEV_PROTECTION_ENABLE, 0
.set CYDEV_STACK_SIZE, 0x4000
.set CYDEV_VDDA_MV, 5000
.set CYDEV_VDDD_MV, 5000
.set CYDEV_VDDIO0_MV, 5000
.set CYDEV_VDDIO1_MV, 5000
.set CYDEV_VDDIO2_MV, 5000
.set CYDEV_VDDIO3_MV, 5000
.set CYDEV_VIO0, 5
.set CYDEV_VIO0_MV, 5000
.set CYDEV_VIO1, 5
.set CYDEV_VIO1_MV, 5000
.set CYDEV_VIO2, 5
.set CYDEV_VIO2_MV, 5000
.set CYDEV_VIO3, 5
.set CYDEV_VIO3_MV, 5000
.set DMA_CHANNELS_USED__MASK0, 0x00000000
.set CYDEV_BOOTLOADER_ENABLE, 0
.endif
